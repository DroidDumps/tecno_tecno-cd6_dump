/dts-v1/;

/ {
	#address-cells = <0x02>;
	#size-cells = <0x02>;
	compatible = "mediatek,MT6765";
	interrupt-parent = <0x01>;
	model = "MT6765";

	__symbols__ {
		DPIDLE = "/cpus/idle-states/dpidle";
		MCDI_CLUSTER = "/cpus/idle-states/mcdi-cluster";
		MCDI_CPU = "/cpus/idle-states/mcdi-cpu";
		SODI = "/cpus/idle-states/sodi";
		SODI3 = "/cpus/idle-states/sodi3";
		STANDBY = "/cpus/idle-states/standby";
		SUSPEND = "/cpus/idle-states/suspend";
		accdet = "/accdet";
		apdma = "/dma-controller@11000580";
		apmixed = "/apmixed@1000c000";
		audgpio = "/mt_soc_dl1_pcm@11220000";
		audio = "/audio@11220000";
		auxadc = "/auxadc@11001000";
		bat_gm30 = "/battery";
		btcvsd_snd = "/mtk-btcvsd-snd@18050000";
		camsys = "/camsys@1a000000";
		charger = "/charger";
		chosen = "/chosen";
		clk26m = "/clocks/clk26m";
		clk32k = "/clocks/clk32k";
		consys = "/consys@18002000";
		cpu0 = "/cpus/cpu@000";
		cpu1 = "/cpus/cpu@001";
		cpu2 = "/cpus/cpu@002";
		cpu3 = "/cpus/cpu@003";
		cpu4 = "/cpus/cpu@100";
		cpu5 = "/cpus/cpu@101";
		cpu6 = "/cpus/cpu@102";
		cpu7 = "/cpus/cpu@103";
		cpu_dbgapb = "/cpu_dbgapb@0d410000";
		disp_color0 = "/disp_color0@1400f000";
		disp_mutex0 = "/disp_mutex0@14001000";
		dsi_te = "/dsi_te";
		dynamic_options = "/dynamic_options";
		flashlight_core = "/flashlight_core";
		flashlights_aw3644 = "/flashlights_aw3644";
		flashlights_mt6370 = "/flashlights_mt6370";
		gce = "/gce@10238000";
		gce_mbox = "/gce_mbox@10238000";
		gce_mbox_svp = "/gce_mbox_svp@10238000";
		gic = "/interrupt-controller@0c000000";
		goodix_fp = "/fingerprint";
		gpio = "/gpio@10005000";
		gpio_usage_mapping = "/gpio";
		i2c0 = "/i2c0@11007000";
		i2c1 = "/i2c1@11008000";
		i2c2 = "/i2c2@11009000";
		i2c3 = "/i2c3@1100f000";
		i2c4 = "/i2c4@11011000";
		i2c5 = "/i2c5@11016000";
		i2c6 = "/i2c6@1100d000";
		i2c7 = "/i2c7";
		i2c8 = "/i2c8";
		i2c9 = "/i2c9";
		i2c_common = "/i2c_common";
		imgsys = "/imgsys@15020000";
		infracfg_ao = "/infracfg_ao@10001000";
		iommu = "/m4u@10205000";
		irq_nfc = "/irq_nfc";
		irtx_pwm = "/irtx_pwm";
		kd_camera_hw1 = "/kd_camera_hw1@1a040000";
		keypad = "/kp@10010000";
		lk_charger = "/lk_charger";
		main_pmic = "/mt-pmic";
		md1_sim1_hot_plug_eint = "/md1_sim1_hot_plug_eint";
		md1_sim2_hot_plug_eint = "/md1_sim2_hot_plug_eint";
		mdcldma = "/mdcldma@10014000";
		mdp_ccorr = "/mdp_ccorr0@14005000";
		mdp_rdma0 = "/mdp_rdma0@14004000";
		mdp_rsz0 = "/mdp_rsz0@14006000";
		mdp_rsz1 = "/mdp_rsz1@14007000";
		mdp_tdshp0 = "/mdp_tdshp0@1400a000";
		mdp_wdma0 = "/mdp_wdma0@14008000";
		mdp_wrot0 = "/mdp_wrot0@14009000";
		memory_ssmr_features = "/memory-ssmr-features";
		mfg_cfg = "/mfg_cfg@13ffe000";
		mipi_rx_ana_csi0a = "/mipi_rx_ana_csi0a@11c10000";
		mipi_rx_ana_csi0b = "/mipi_rx_ana_csi0b@11c11000";
		mipi_rx_ana_csi1a = "/mipi_rx_ana_csi1a@11c12000";
		mipi_rx_ana_csi1b = "/mipi_rx_ana_csi1b@11c13000";
		mipi_rx_ana_csi2a = "/mipi_rx_ana_csi2a@11c14000";
		mipi_rx_ana_csi2b = "/mipi_rx_ana_csi2b@11c15000";
		mmsys_config = "/mmsys_config@14000000";
		mrdump_ext_rst = "/mrdump_ext_rst";
		msdc0 = "/msdc@11230000";
		msdc0_pins_default = "/pinctrl@1000b000/msdc0@default";
		msdc0_pins_hs200 = "/pinctrl@1000b000/msdc0@hs200";
		msdc0_pins_hs400 = "/pinctrl@1000b000/msdc0@hs400";
		msdc0_register_setting_default = "/pinctrl@1000b000/msdc0@register_default";
		msdc1 = "/msdc@11240000";
		msdc1_ins = "/msdc1_ins@0";
		msdc1_pins_ddr50 = "/pinctrl@1000b000/msdc1@ddr50";
		msdc1_pins_default = "/pinctrl@1000b000/msdc1@default";
		msdc1_pins_sdr104 = "/pinctrl@1000b000/msdc1@sdr104";
		msdc1_pins_sdr50 = "/pinctrl@1000b000/msdc1@sdr50";
		msdc1_register_setting_default = "/pinctrl@1000b000/msdc1@register_default";
		msdc2 = "/msdc@11250000";
		msdc3 = "/msdc@11260000";
		msdc3_pins_default = "/pinctrl@1000b000/msdc3@default";
		msdc3_register_setting_default = "/pinctrl@1000b000/msdc3@register_default";
		mt6370_pmu = "/mt6370_pmu_dts";
		mt6370_typec = "/type_c_port0";
		mt_charger = "/mt_charger";
		mt_pmic_vaud28_ldo_reg = "/mt-pmic/ldo_regulators/ldo_vaud28";
		mt_pmic_vaux18_ldo_reg = "/mt-pmic/ldo_regulators/ldo_vaux18";
		mt_pmic_vcama_ldo_reg = "/mt-pmic/ldo_regulators/ldo_vcama";
		mt_pmic_vcamd_ldo_reg = "/mt-pmic/ldo_regulators/ldo_vcamd";
		mt_pmic_vcamio_ldo_reg = "/mt-pmic/ldo_regulators/ldo_vcamio";
		mt_pmic_vcn18_ldo_reg = "/mt-pmic/ldo_regulators/ldo_vcn18";
		mt_pmic_vcn28_ldo_reg = "/mt-pmic/ldo_regulators/ldo_vcn28";
		mt_pmic_vcn33_bt_ldo_reg = "/mt-pmic/ldo_regulators/ldo_vcn33_bt";
		mt_pmic_vcn33_wifi_ldo_reg = "/mt-pmic/ldo_regulators/ldo_vcn33_wifi";
		mt_pmic_vcore_buck_reg = "/mt-pmic/buck_regulators/buck_vcore";
		mt_pmic_vdram_ldo_reg = "/mt-pmic/ldo_regulators/ldo_vdram";
		mt_pmic_vefuse_ldo_reg = "/mt-pmic/ldo_regulators/ldo_vefuse";
		mt_pmic_vemc_ldo_reg = "/mt-pmic/ldo_regulators/ldo_vemc";
		mt_pmic_vfe28_ldo_reg = "/mt-pmic/ldo_regulators/ldo_vfe28";
		mt_pmic_vibr_ldo_reg = "/mt-pmic/ldo_regulators/ldo_vibr";
		mt_pmic_vio18_ldo_reg = "/mt-pmic/ldo_regulators/ldo_vio18";
		mt_pmic_vio28_ldo_reg = "/mt-pmic/ldo_regulators/ldo_vio28";
		mt_pmic_vldo28_ldo_reg = "/mt-pmic/ldo_regulators/ldo_vldo28";
		mt_pmic_vmc_ldo_reg = "/mt-pmic/ldo_regulators/ldo_vmc";
		mt_pmic_vmch_ldo_reg = "/mt-pmic/ldo_regulators/ldo_vmch";
		mt_pmic_vmodem_buck_reg = "/mt-pmic/buck_regulators/buck_vmodem";
		mt_pmic_vpa_buck_reg = "/mt-pmic/buck_regulators/buck_vpa";
		mt_pmic_vproc_buck_reg = "/mt-pmic/buck_regulators/buck_vproc";
		mt_pmic_vrf12_ldo_reg = "/mt-pmic/ldo_regulators/ldo_vrf12";
		mt_pmic_vrf18_ldo_reg = "/mt-pmic/ldo_regulators/ldo_vrf18";
		mt_pmic_vs1_buck_reg = "/mt-pmic/buck_regulators/buck_vs1";
		mt_pmic_vsim1_ldo_reg = "/mt-pmic/ldo_regulators/ldo_vsim1";
		mt_pmic_vsim2_ldo_reg = "/mt-pmic/ldo_regulators/ldo_vsim2";
		mt_pmic_vsram_others_ldo_reg = "/mt-pmic/ldo_regulators/ldo_vsram_others";
		mt_pmic_vsram_proc_ldo_reg = "/mt-pmic/ldo_regulators/ldo_vsram_proc";
		mt_pmic_vusb33_ldo_reg = "/mt-pmic/ldo_regulators/ldo_vusb33";
		mt_pmic_vxo22_ldo_reg = "/mt-pmic/ldo_regulators/ldo_vxo22";
		mtkfb = "/mtkfb@0";
		nfc = "/nfc";
		odm = "/odm";
		otg_iddig = "/otg_iddig";
		pericfg = "/pericfg@10003000";
		pio = "/pinctrl@1000b000";
		pmic_auxadc = "/mt-pmic/mt635x-auxadc";
		pmic_clock_buffer_ctrl = "/pmic_clock_buffer_ctrl";
		pwm = "/pwm@11006000";
		radio_md_cfg = "/radio_md_cfg";
		reserved_memory = "/reserved-memory";
		scpsys = "/scpsys@10001000";
		smart_pa = "/smart_pa";
		smi_larb0 = "/smi_larb0@14003000";
		smi_larb1 = "/smi_larb1@17010000";
		smi_larb2 = "/smi_larb2@15021000";
		smi_larb3 = "/smi_larb3@1a002000";
		spi0 = "/spi@1100a000";
		spi1 = "/spi@11010000";
		spi2 = "/spi@11012000";
		spi3 = "/spi@11013000";
		spi4 = "/spi@11014000";
		spi5 = "/spi@11015000";
		syscfg_pctl_0 = "/syscfg_pctl_0@10005000";
		syscfg_pctl_1 = "/syscfg_pctl_1@0x10002000";
		syscfg_pctl_2 = "/syscfg_pctl_2@0x10002200";
		syscfg_pctl_3 = "/syscfg_pctl_3@0x10002400";
		syscfg_pctl_4 = "/syscfg_pctl_4@0x10002600";
		syscfg_pctl_5 = "/syscfg_pctl_5@0x10002800";
		syscfg_pctl_6 = "/syscfg_pctl_6@0x10002a00";
		syscfg_pctl_7 = "/syscfg_pctl_7@0x10002c00";
		sysirq = "/intpol-controller@10200a80";
		topckgen = "/topckgen@10000000";
		touch = "/touch";
		tran_battery = "/tran_battery";
		uart0 = "/serial@11020000";
		uart1 = "/serial@11030000";
		venc_gcon = "/venc_gcon@17000000";
	};

	accdet {
		compatible = "mediatek,pmic-accdet";
		linux,phandle = <0x76>;
		phandle = <0x76>;
	};

	aes_top0@10016000 {
		compatible = "mediatek,aes_top0";
		reg = <0x00 0x10016000 0x00 0x1000>;
	};

	amms_control {
		compatible = "mediatek,amms";
		interrupts = <0x00 0x86 0x01>;
	};

	ap_ccif0@10209000 {
		compatible = "mediatek,ap_ccif0";
		interrupts = <0x00 0x94 0x08>;
		reg = <0x00 0x10209000 0x00 0x1000>;
	};

	ap_ccif1@1020b000 {
		compatible = "mediatek,ap_ccif1";
		interrupts = <0x00 0x96 0x08>;
		reg = <0x00 0x1020b000 0x00 0x1000>;
	};

	ap_ccif2@1023c000 {
		compatible = "mediatek,ap_ccif2";
		interrupts = <0x00 0x8f 0x08>;
		reg = <0x00 0x1023c000 0x00 0x1000>;
	};

	ap_ccif3@1023e000 {
		compatible = "mediatek,ap_ccif3";
		interrupts = <0x00 0x92 0x08>;
		reg = <0x00 0x1023e000 0x00 0x1000>;
	};

	ap_dma@11000000 {
		compatible = "mediatek,ap_dma";
		interrupts = <0x00 0x61 0x08>;
		reg = <0x00 0x11000000 0x00 0x1000>;
	};

	apcldmain@1021b000 {
		compatible = "mediatek,apcldmain";
		reg = <0x00 0x1021b000 0x00 0x00>;
	};

	apcldmain_ao@10014000 {
		compatible = "mediatek,apcldmain_ao";
		reg = <0x00 0x10014000 0x00 0x400>;
	};

	apcldmamisc@1021b800 {
		compatible = "mediatek,apcldmamisc";
		interrupts = <0x00 0xa5 0x04>;
		reg = <0x00 0x1021b800 0x00 0x00>;
	};

	apcldmamisc_ao@10014800 {
		compatible = "mediatek,apcldmamisc_ao";
		reg = <0x00 0x10014800 0x00 0x400>;
	};

	apcldmaout@1021b400 {
		compatible = "mediatek,apcldmaout";
		reg = <0x00 0x1021b400 0x00 0x00>;
	};

	apcldmaout_ao@10014400 {
		compatible = "mediatek,apcldmaout_ao";
		reg = <0x00 0x10014400 0x00 0x400>;
	};

	apmixed@1000c000 {
		#clock-cells = <0x01>;
		compatible = "mediatek,apmixed\0syscon";
		linux,phandle = <0x41>;
		phandle = <0x41>;
		reg = <0x00 0x1000c000 0x00 0x1000>;
	};

	apxgpt@10008000 {
		clocks = <0x1d>;
		compatible = "mediatek,apxgpt";
		interrupts = <0x00 0xaa 0x08>;
		reg = <0x00 0x10008000 0x00 0x1000>;
	};

	atf_logger {
		compatible = "mediatek,atf_logger";
		interrupts = <0x00 0xf7 0x01>;
	};

	audio@11220000 {
		#clock-cells = <0x01>;
		compatible = "mediatek,audio\0syscon";
		linux,phandle = <0x40>;
		mediatek,btcvsd_snd = <0x3f>;
		phandle = <0x40>;
		reg = <0x00 0x11220000 0x00 0x1000>;
	};

	audio_snd_card {
		compatible = "mediatek,audio_snd_card";
	};

	audio_sram@11221000 {
		compatible = "mediatek,audio_sram";
		reg = <0x00 0x11221000 0x00 0x9000>;
	};

	auxadc@11001000 {
		clock-names = "auxadc-main";
		clocks = <0x24 0x21>;
		compatible = "mediatek,auxadc";
		interrupts = <0x00 0x4c 0x02>;
		linux,phandle = <0x7b>;
		phandle = <0x7b>;
		reg = <0x00 0x11001000 0x00 0x10000>;
	};

	battery {
		CAR_TUNE_VALUE = <0x64>;
		DIFFERENCE_FULLOCV_ITH = <0xc8>;
		EMBEDDED_SEL = <0x01>;
		FG_METER_RESISTANCE = <0x4b>;
		KEEP_100_PERCENT = <0x01>;
		PMIC_MIN_VOL = <0x82dc>;
		PMIC_SHUTDOWN_CURRENT = <0x14>;
		POWERON_SYSTEM_IBOOT = <0x1f4>;
		Q_MAX_SYS_VOLTAGE_BAT0 = <0xd16>;
		Q_MAX_SYS_VOLTAGE_BAT1 = <0xd16>;
		Q_MAX_SYS_VOLTAGE_BAT2 = <0xd16>;
		Q_MAX_SYS_VOLTAGE_BAT3 = <0xd16>;
		R_FG_VALUE = <0x0a>;
		SHUTDOWN_1_TIME = <0x1e>;
		SHUTDOWN_GAUGE0_VOLTAGE = <0x84d0>;
		TEMPERATURE_T0 = <0x32>;
		TEMPERATURE_T1 = <0x19>;
		TEMPERATURE_T2 = <0x0a>;
		TEMPERATURE_T3 = <0x00>;
		TEMPERATURE_T4 = <0xfffffff6>;
		battery0_profile_t0 = <0x00 0xaaaa 0x44c 0x1f9 0xa9f4 0x44c 0x3f2 0xa95d 0x469 0x5eb 0xa8c6 0x44c 0x7e4 0xa843 0x44c 0x9dd 0xa7c0 0x44e 0xbd6 0xa746 0x468 0xdcf 0xa6c4 0x44c 0xfc8 0xa64a 0x44e 0x11c1 0xa5d0 0x467 0x13bb 0xa54f 0x44f 0x15b4 0xa4df 0x46a 0x17ad 0xa465 0x466 0x19a6 0xa3ec 0x44c 0x1b9f 0xa374 0x450 0x1d98 0xa304 0x46a 0x1f91 0xa28c 0x46a 0x218a 0xa21b 0x465 0x2383 0xa1a4 0x44c 0x257c 0xa135 0x450 0x2775 0xa0c6 0x45c 0x296e 0xa059 0x457 0x2b67 0x9ff2 0x47a 0x2d60 0x9f85 0x46f 0x2f59 0x9f1d 0x479 0x3152 0x9eb1 0x467 0x334b 0x9e4c 0x463 0x3544 0x9de9 0x46f 0x373d 0x9d8c 0x47e 0x3936 0x9d2a 0x487 0x3b30 0x9cd2 0x49c 0x3d29 0x9c74 0x49c 0x3f22 0x9c19 0x49c 0x411b 0x9bc1 0x4a3 0x4314 0x9b6d 0x4b0 0x450d 0x9b16 0x4b0 0x4706 0x9ac5 0x4bb 0x48ff 0x9a74 0x4ce 0x4af8 0x9a27 0x4d6 0x4cf1 0x99dc 0x4ee 0x4eea 0x998c 0x500 0x50e3 0x993b 0x508 0x52dc 0x98dd 0x50c 0x54d5 0x9866 0x4ea 0x56ce 0x97e2 0x4aa 0x58c7 0x9771 0x47e 0x5ac0 0x971b 0x475 0x5cb9 0x96cf 0x45c 0x5eb2 0x968d 0x44c 0x60ab 0x9655 0x45b 0x62a5 0x961e 0x45b 0x649e 0x95e6 0x44c 0x6697 0x95b9 0x45c 0x6890 0x958b 0x45a 0x6a89 0x955e 0x45c 0x6c82 0x9536 0x46a 0x6e7b 0x950d 0x46a 0x7074 0x94e5 0x46a 0x726d 0x94bd 0x46a 0x7466 0x949a 0x46a 0x765f 0x947c 0x476 0x7858 0x9457 0x47e 0x7a51 0x9435 0x47e 0x7c4a 0x941d 0x491 0x7e43 0x9403 0x49c 0x803c 0x93eb 0x4a9 0x8235 0x93d0 0x4b0 0x842e 0x93b8 0x4b0 0x8627 0x939d 0x4b0 0x8820 0x937f 0x4b0 0x8a1a 0x9353 0x4a2 0x8c13 0x930b 0x478 0x8e0c 0x92c8 0x46a 0x9005 0x9293 0x46a 0x91fe 0x9270 0x479 0x93f7 0x924a 0x47e 0x95f0 0x921a 0x46f 0x97e9 0x91ef 0x46a 0x99e2 0x91ce 0x47a 0x9bdb 0x91b0 0x47e 0x9dd4 0x918a 0x47e 0x9fcd 0x9161 0x497 0xa1c6 0x9128 0x49c 0xa3bf 0x90e3 0x483 0xa5b8 0x90a5 0x47e 0xa7b1 0x9071 0x498 0xa9aa 0x901c 0x482 0xaba3 0x8fd2 0x452 0xad9c 0x8fc1 0x467 0xaf95 0x8fb7 0x47c 0xb18f 0x8fad 0x499 0xb388 0x8f9a 0x4ae 0xb581 0x8f85 0x4fa 0xb77a 0x8f42 0x513 0xb973 0x8e3e 0x4d2 0xbb6c 0x8c77 0x4e1 0xbd65 0x8a1e 0x512 0xbf5e 0x86d5 0x562 0xc157 0x86c4 0x564 0xc350 0x86c4 0x564>;
		battery0_profile_t0_num = <0x64>;
		battery0_profile_t1 = <0x00 0xab54 0x65e 0x1f9 0xaa80 0x65e 0x3f2 0xa9d5 0x65e 0x5eb 0xa948 0x65d 0x7e4 0xa8bb 0x640 0x9dd 0xa837 0x640 0xbd6 0xa7b4 0x63f 0xdcf 0xa732 0x62c 0xfc8 0xa6b8 0x62c 0x11c1 0xa63f 0x62c 0x13bb 0xa5c6 0x62c 0x15b4 0xa54d 0x62c 0x17ad 0xa4d3 0x62c 0x19a6 0xa45a 0x628 0x1b9f 0xa3e1 0x60e 0x1d98 0xa369 0x60e 0x1f91 0xa2f9 0x60e 0x218a 0xa281 0x60e 0x2383 0xa212 0x60e 0x257c 0xa1a3 0x60e 0x2775 0xa134 0x614 0x296e 0xa0c5 0x626 0x2b67 0xa056 0x60e 0x2d60 0x9fe9 0x615 0x2f59 0x9f81 0x625 0x3152 0x9f17 0x61b 0x334b 0x9eba 0x640 0x3544 0x9e55 0x640 0x373d 0x9ded 0x640 0x3936 0x9d7e 0x640 0x3b30 0x9d0f 0x640 0x3d29 0x9ca6 0x646 0x3f22 0x9c4e 0x65e 0x411b 0x9bfd 0x672 0x4314 0x9bb0 0x67c 0x450d 0x9b66 0x690 0x4706 0x9b15 0x697 0x48ff 0x9ac4 0x6a4 0x4af8 0x9a73 0x6b0 0x4cf1 0x9a22 0x6ca 0x4eea 0x99d2 0x6d6 0x50e3 0x9981 0x6e2 0x52dc 0x9923 0x6df 0x54d5 0x98b4 0x6ac 0x56ce 0x9841 0x66c 0x58c7 0x97cc 0x629 0x5ac0 0x9762 0x5ed 0x5cb9 0x970b 0x5c8 0x5eb2 0x96c4 0x5b9 0x60ab 0x9682 0x5aa 0x62a5 0x9646 0x5aa 0x649e 0x960e 0x5aa 0x6697 0x95dc 0x5aa 0x6890 0x95af 0x5aa 0x6a89 0x9586 0x5ba 0x6c82 0x9558 0x5b7 0x6e7b 0x9531 0x5bb 0x7074 0x950d 0x5b7 0x726d 0x94e5 0x5aa 0x7466 0x94c2 0x5bc 0x765f 0x949e 0x5b6 0x7858 0x947c 0x5aa 0x7a51 0x945d 0x5bd 0x7c4a 0x9445 0x5d5 0x7e43 0x942b 0x5dc 0x803c 0x9413 0x5f0 0x8235 0x93f8 0x5e6 0x842e 0x93e0 0x5f0 0x8627 0x93cc 0x608 0x8820 0x93b1 0x600 0x8a1a 0x939a 0x5fa 0x8c13 0x937e 0x5e4 0x8e0c 0x9360 0x5dc 0x9005 0x9342 0x5cd 0x91fe 0x9324 0x5c8 0x93f7 0x92fe 0x5c8 0x95f0 0x92dd 0x5c8 0x97e9 0x92b7 0x5c8 0x99e2 0x928e 0x5c8 0x9bdb 0x926e 0x5d8 0x9dd4 0x9248 0x5dc 0x9fcd 0x921f 0x5dc 0xa1c6 0x91f7 0x605 0xa3bf 0x91b5 0x5fd 0xa5b8 0x9177 0x60b 0xa7b1 0x913a 0x628 0xa9aa 0x90fe 0x62c 0xaba3 0x90a7 0x62c 0xad9c 0x905e 0x63e 0xaf95 0x9044 0x65b 0xb18f 0x9030 0x670 0xb388 0x9025 0x6a0 0xb581 0x9011 0x6d2 0xb77a 0x8ff4 0x734 0xb973 0x8fb0 0x799 0xbb6c 0x8ecf 0x7bb 0xbd65 0x8cf5 0x7ec 0xbf5e 0x8a73 0x8b2 0xc157 0x86f5 0x9df 0xc350 0x86ec 0x9e2>;
		battery0_profile_t1_num = <0x64>;
		battery0_profile_t2 = <0x00 0xab0e 0xc3a 0x1f9 0xaa44 0xc3a 0x3f2 0xa9a3 0xc1c 0x5eb 0xa916 0xc07 0x7e4 0xa893 0xbe9 0x9dd 0xa80f 0xbd3 0xbd6 0xa78c 0xba1 0xdcf 0xa70a 0xb70 0xfc8 0xa690 0xb52 0x11c1 0xa617 0xb3b 0x13bb 0xa59e 0xb0b 0x15b4 0xa525 0xaee 0x17ad 0xa4ad 0xadc 0x19a6 0xa43c 0xad5 0x1b9f 0xa3c3 0xaa6 0x1d98 0xa34b 0xa8c 0x1f91 0xa2dc 0xa89 0x218a 0xa26d 0xa78 0x2383 0xa1fc 0xa73 0x257c 0xa185 0xa56 0x2775 0xa116 0xa46 0x296e 0xa0a7 0xa46 0x2b67 0xa03a 0xa46 0x2d60 0x9fd5 0xa4b 0x2f59 0x9f70 0xa5a 0x3152 0x9f10 0xa67 0x334b 0x9eba 0xa8c 0x3544 0x9e52 0xa8c 0x373d 0x9dda 0xa7e 0x3936 0x9d4d 0xa54 0x3b30 0x9cc6 0xa46 0x3d29 0x9c53 0xa46 0x3f22 0x9bf4 0xa4c 0x411b 0x9ba7 0xa64 0x4314 0x9b60 0xa7f 0x450d 0x9b19 0xa8c 0x4706 0x9acf 0xa8c 0x48ff 0x9a7e 0xa8c 0x4af8 0x9a29 0xa84 0x4cf1 0x99cf 0xa78 0x4eea 0x9970 0xa64 0x50e3 0x9906 0xa25 0x52dc 0x989c 0x9ee 0x54d5 0x9832 0x9bf 0x56ce 0x97c8 0x973 0x58c7 0x9767 0x935 0x5ac0 0x9715 0x91a 0x5cb9 0x96cf 0x91a 0x5eb2 0x9688 0x90b 0x60ab 0x964b 0x8fc 0x62a5 0x9614 0x8fc 0x649e 0x95dc 0x8fc 0x6697 0x95aa 0x8fc 0x6890 0x957d 0x90c 0x6a89 0x9554 0x91a 0x6c82 0x952c 0x925 0x6e7b 0x9503 0x92e 0x7074 0x94db 0x93f 0x726d 0x94b3 0x93a 0x7466 0x9490 0x940 0x765f 0x9472 0x958 0x7858 0x9454 0x960 0x7a51 0x9435 0x973 0x7c4a 0x9417 0x97e 0x7e43 0x93ff 0x98b 0x803c 0x93eb 0x992 0x8235 0x93d7 0x9a6 0x842e 0x93c2 0x9b0 0x8627 0x93ae 0x9be 0x8820 0x93a1 0x9d9 0x8a1a 0x9397 0xa05 0x8c13 0x9386 0xa14 0x8e0c 0x9371 0xa23 0x9005 0x935d 0xa3e 0x91fe 0x9349 0xa55 0x93f7 0x932d 0xa80 0x95f0 0x9307 0xaa3 0x97e9 0x92e7 0xad1 0x99e2 0x92c0 0xaec 0x9bdb 0x9298 0xb18 0x9dd4 0x9270 0xb63 0x9fcd 0x923f 0xbab 0xa1c6 0x9204 0xbe1 0xa3bf 0x91c8 0xc2d 0xa5b8 0x9183 0xc75 0xa7b1 0x9144 0xcf0 0xa9aa 0x90f7 0xd59 0xaba3 0x90a6 0xdbe 0xad9c 0x9067 0xe4f 0xaf95 0x903c 0xef9 0xb18f 0x9026 0x1009 0xb388 0x8fff 0x111a 0xb581 0x8fd7 0x12a4 0xb77a 0x8f9c 0x1467 0xb973 0x8f26 0x165d 0xbb6c 0x8e27 0x1886 0xbd65 0x8c41 0x1b43 0xbf5e 0x898e 0x2083 0xc157 0x85b6 0x2a03 0xc350 0x85ac 0x2a1c>;
		battery0_profile_t2_num = <0x64>;
		battery0_profile_t3 = <0x00 0xab2c 0x1838 0x1f9 0xaa3a 0x1836 0x3f2 0xa97b 0x178a 0x5eb 0xa8d9 0x16d8 0x7e4 0xa842 0x1698 0x9dd 0xa7b5 0x16f5 0xbd6 0xa732 0x16c0 0xdcf 0xa6af 0x1660 0xfc8 0xa62b 0x1640 0x11c1 0xa5a9 0x160d 0x13bb 0xa530 0x15db 0x15b4 0xa4b7 0x15a6 0x17ad 0xa43d 0x155e 0x19a6 0xa3c6 0x1511 0x1b9f 0xa356 0x14dc 0x1d98 0xa2e7 0x1476 0x1f91 0xa278 0x1378 0x218a 0xa209 0x1329 0x2383 0xa19a 0x1358 0x257c 0xa12b 0x13c0 0x2775 0xa0bc 0x13ce 0x296e 0xa04f 0x139b 0x2b67 0x9fec 0x1372 0x2d60 0x9f91 0x1371 0x2f59 0x9f36 0x138f 0x3152 0x9ed6 0x139e 0x334b 0x9e62 0x137b 0x3544 0x9ddf 0x133b 0x373d 0x9d5b 0x12c8 0x3936 0x9cdb 0x1227 0x3b30 0x9c65 0x11a2 0x3d29 0x9bf9 0x11b3 0x3f22 0x9b97 0x1212 0x411b 0x9b43 0x1259 0x4314 0x9af9 0x1270 0x450d 0x9aab 0x125c 0x4706 0x9a5d 0x1255 0x48ff 0x9a02 0x123d 0x4af8 0x99a7 0x1217 0x4cf1 0x994d 0x11e4 0x4eea 0x98ee 0x11aa 0x50e3 0x988d 0x115f 0x52dc 0x9832 0x10f0 0x54d5 0x97d7 0x107c 0x56ce 0x977c 0x1030 0x58c7 0x972a 0x1056 0x5ac0 0x96df 0x10c1 0x5cb9 0x9698 0x10cc 0x5eb2 0x9656 0x10c2 0x60ab 0x9619 0x10c2 0x62a5 0x95e2 0x10b3 0x649e 0x95aa 0x10a9 0x6697 0x957d 0x10d2 0x6890 0x954f 0x1105 0x6a89 0x9522 0x1127 0x6c82 0x94fa 0x1141 0x6e7b 0x94d1 0x113d 0x7074 0x94a9 0x1141 0x726d 0x9486 0x116b 0x7466 0x9468 0x119e 0x765f 0x944a 0x11be 0x7858 0x9432 0x11d8 0x7a51 0x941d 0x11f1 0x7c4a 0x9409 0x120b 0x7e43 0x93f5 0x1243 0x803c 0x93e7 0x12b1 0x8235 0x93d7 0x130d 0x842e 0x93c9 0x1368 0x8627 0x93bf 0x13bf 0x8820 0x93ae 0x141e 0x8a1a 0x939a 0x1483 0x8c13 0x938d 0x14f6 0x8e0c 0x937b 0x1577 0x9005 0x9360 0x15bf 0x91fe 0x9349 0x1626 0x93f7 0x932d 0x16cc 0x95f0 0x930f 0x177b 0x97e9 0x92e9 0x1817 0x99e2 0x92c8 0x18c6 0x9bdb 0x92a2 0x1974 0x9dd4 0x9272 0x1a0f 0x9fcd 0x923f 0x1ae8 0xa1c6 0x9204 0x1b9f 0xa3bf 0x91c8 0x1c7d 0xa5b8 0x918b 0x1d76 0xa7b1 0x9146 0x1e59 0xa9aa 0x9108 0x1f7d 0xaba3 0x90c2 0x20c6 0xad9c 0x9085 0x21f9 0xaf95 0x9051 0x241a 0xb18f 0x901f 0x2663 0xb388 0x8fec 0x28d2 0xb581 0x8fb0 0x2b7c 0xb77a 0x8f74 0x2e7f 0xb973 0x8f1b 0x3193 0xbb6c 0x8e7c 0x33dd 0xbd65 0x8d7a 0x35d9 0xbf5e 0x8baf 0x38c7 0xc157 0x88f1 0x3ea3 0xc350 0x84bc 0x47fe>;
		battery0_profile_t3_num = <0x64>;
		battery0_profile_t4 = <0x00 0xab22 0x3250 0x1f9 0xaa12 0x324f 0x3f2 0xa92a 0x31fd 0x5eb 0xa86a 0x314e 0x7e4 0xa7ac 0x3053 0x9dd 0xa70a 0x2f6b 0xbd6 0xa668 0x2e8c 0xdcf 0xa5c8 0x2da8 0xfc8 0xa53b 0x2cfb 0x11c1 0xa4ae 0x2c47 0x13bb 0xa42b 0x2b9d 0x15b4 0xa3a9 0x2b05 0x17ad 0xa32f 0x2a70 0x19a6 0xa2b6 0x29ea 0x1b9f 0xa23d 0x2957 0x1d98 0xa1c5 0x28dc 0x1f91 0xa156 0x285b 0x218a 0xa0e9 0x27e5 0x2383 0xa084 0x2780 0x257c 0xa021 0x271f 0x2775 0x9fc2 0x26ca 0x296e 0x9f53 0x2665 0x2b67 0x9ee1 0x25fb 0x2d60 0x9e63 0x2579 0x2f59 0x9dd6 0x24dc 0x3152 0x9d4b 0x2451 0x334b 0x9cca 0x23d6 0x3544 0x9c54 0x2379 0x373d 0x9be8 0x2338 0x3936 0x9b86 0x230b 0x3b30 0x9b2e 0x22f6 0x3d29 0x9ada 0x22f0 0x3f22 0x9a82 0x22e2 0x411b 0x9a2e 0x22d8 0x4314 0x99d3 0x22b3 0x450d 0x997c 0x2280 0x4706 0x9927 0x223c 0x48ff 0x98d0 0x21e9 0x4af8 0x987b 0x21b7 0x4cf1 0x9824 0x2184 0x4eea 0x97d8 0x2166 0x50e3 0x978d 0x2151 0x52dc 0x9740 0x2134 0x54d5 0x96fa 0x211e 0x56ce 0x96b7 0x20f9 0x58c7 0x967b 0x20ee 0x5ac0 0x963e 0x20ee 0x5cb9 0x9602 0x20e0 0x5eb2 0x95ca 0x20df 0x60ab 0x9597 0x20ee 0x62a5 0x956a 0x20f8 0x649e 0x953c 0x2111 0x6697 0x950f 0x212b 0x6890 0x94e7 0x2144 0x6a89 0x94c4 0x216d 0x6c82 0x94a5 0x21a0 0x6e7b 0x948d 0x21de 0x7074 0x9478 0x222a 0x726d 0x9464 0x2269 0x7466 0x9450 0x22ba 0x765f 0x943c 0x230c 0x7858 0x9428 0x2366 0x7a51 0x9413 0x23cb 0x7c4a 0x93ff 0x2430 0x7e43 0x93f2 0x24b5 0x803c 0x93e1 0x253f 0x8235 0x93cd 0x25d0 0x842e 0x93b8 0x2668 0x8627 0x93a4 0x26ff 0x8820 0x9390 0x27a4 0x8a1a 0x937c 0x2857 0x8c13 0x9368 0x2906 0x8e0c 0x934c 0x29b9 0x9005 0x9335 0x2a8c 0x91fe 0x931a 0x2b4d 0x93f7 0x92fb 0x2c21 0x95f0 0x92dd 0x2cf0 0x97e9 0x92b7 0x2dba 0x99e2 0x928e 0x2e9b 0x9bdb 0x9266 0x2f7c 0x9dd4 0x923e 0x3072 0x9fcd 0x920d 0x315e 0xa1c6 0x91db 0x3257 0xa3bf 0x91a0 0x3354 0xa5b8 0x916c 0x3461 0xa7b1 0x9128 0x354f 0xa9aa 0x90ea 0x365b 0xaba3 0x90ad 0x3786 0xad9c 0x9071 0x38b5 0xaf95 0x903d 0x39ff 0xb18f 0x9014 0x3b5e 0xb388 0x8feb 0x3cee 0xb581 0x8fc3 0x3eb0 0xb77a 0x8f88 0x40b8 0xb973 0x8f25 0x42ff 0xbb6c 0x8e6a 0x459f 0xbd65 0x8d05 0x48f2 0xbf5e 0x8acc 0x4e37 0xc157 0x877f 0x54d7 0xc350 0x866a 0x5226>;
		battery0_profile_t4_num = <0x64>;
		battery2_profile_t0 = <0x00 0xabb8 0x4ba 0x1fb 0xaaeb 0x4ba 0x3f6 0xaa5b 0x4c4 0x5f1 0xa9d5 0x4c4 0x7ec 0xa95a 0x4c4 0x9e7 0xa8e0 0x4c4 0xbe2 0xa865 0x4c6 0xddd 0xa7f1 0x4cc 0xfd9 0xa775 0x4c7 0x11d4 0xa6fa 0x4ce 0x13cf 0xa682 0x4ce 0x15ca 0xa60d 0x4ce 0x17c5 0xa591 0x4ce 0x19c0 0xa519 0x4ce 0x1bbb 0xa4a3 0x4ce 0x1db6 0xa42d 0x4d3 0x1fb1 0xa3bb 0x4d3 0x21ac 0xa34a 0x4ce 0x23a7 0xa2d2 0x4d4 0x25a2 0xa25d 0x4d2 0x279d 0xa1ec 0x4d4 0x2998 0xa181 0x4d8 0x2b94 0xa113 0x4d8 0x2d8f 0xa0a1 0x4df 0x2f8a 0xa038 0x4db 0x3185 0x9fc9 0x4e0 0x3380 0x9f60 0x4ea 0x357b 0x9ef8 0x4e4 0x3776 0x9e91 0x4e2 0x3971 0x9e2b 0x4f4 0x3b6c 0x9dcd 0x4ff 0x3d67 0x9d66 0x4f6 0x3f62 0x9d09 0x500 0x415d 0x9cac 0x500 0x4358 0x9c50 0x50a 0x4553 0x9bf3 0x515 0x474f 0x9b97 0x51e 0x494a 0x9b43 0x51f 0x4b45 0x9ae8 0x52c 0x4d40 0x9a96 0x53e 0x4f3b 0x9a41 0x546 0x5136 0x99e4 0x549 0x5331 0x997e 0x547 0x552c 0x9903 0x528 0x5727 0x9888 0x50a 0x5922 0x9814 0x4ea 0x5b1d 0x97b4 0x4d8 0x5d18 0x9766 0x4d3 0x5f13 0x971e 0x4c9 0x610e 0x96dc 0x4c4 0x630a 0x969e 0x4bf 0x6505 0x9665 0x4c0 0x6700 0x9632 0x4be 0x68fb 0x95f8 0x4c0 0x6af6 0x95c8 0x4c4 0x6cf1 0x9597 0x4c4 0x6eec 0x9564 0x4c4 0x70e7 0x9538 0x4cc 0x72e2 0x950f 0x4ce 0x74dd 0x94e6 0x4ce 0x76d8 0x94bc 0x4ce 0x78d3 0x949c 0x4d7 0x7ace 0x9473 0x4e1 0x7cc9 0x9454 0x4e2 0x7ec5 0x9435 0x4ec 0x80c0 0x940c 0x4ec 0x82bb 0x93ed 0x4ed 0x84b6 0x93d7 0x4ff 0x86b1 0x93b0 0x4f8 0x88ac 0x9398 0x508 0x8aa7 0x9364 0x4f4 0x8ca2 0x932d 0x4e6 0x8e9d 0x92e5 0x4ca 0x9098 0x92a2 0x4bc 0x9293 0x9271 0x4c9 0x948e 0x9245 0x4d5 0x9689 0x9214 0x4ce 0x9884 0x91eb 0x4ca 0x9a80 0x91c2 0x4cc 0x9c7b 0x919d 0x4d4 0x9e76 0x917a 0x4d3 0xa071 0x9150 0x4dd 0xa26c 0x9122 0x4e2 0xa467 0x90e9 0x4dd 0xa662 0x90ab 0x4d8 0xa85d 0x9073 0x4d8 0xaa58 0x9033 0x4e5 0xac53 0x8fe4 0x4d1 0xae4e 0x8fb5 0x4b6 0xb049 0x8fa5 0x4c6 0xb244 0x8f9a 0x4dd 0xb43f 0x8f90 0x50a 0xb63b 0x8f75 0x52d 0xb836 0x8f4e 0x55d 0xba31 0x8ecc 0x549 0xbc2c 0x8cc0 0x50d 0xbe27 0x882b 0x547 0xc022 0x85a2 0x564 0xc21d 0x85a2 0x564 0xc418 0x85a2 0x564>;
		battery2_profile_t0_num = <0x64>;
		battery2_profile_t1 = <0x00 0xabcc 0x5b4 0x1fb 0xab31 0x5b8 0x3f6 0xaaac 0x62e 0x5f1 0xaa31 0x64a 0x7ec 0xa9be 0x649 0x9e7 0xa945 0x63e 0xbe2 0xa8d1 0x634 0xddd 0xa857 0x62c 0xfd9 0xa7e3 0x629 0x11d4 0xa768 0x61c 0x13cf 0xa6f0 0x60e 0x15ca 0xa67e 0x60b 0x17c5 0xa609 0x600 0x19c0 0xa591 0x5fe 0x1bbb 0xa520 0x600 0x1db6 0xa4ab 0x5f5 0x1fb1 0xa433 0x5f0 0x21ac 0xa3c2 0x5f0 0x23a7 0xa350 0x5f0 0x25a2 0xa2e0 0x5f0 0x279d 0xa26e 0x5ea 0x2998 0xa203 0x5ec 0x2b94 0xa195 0x5f0 0x2d8f 0xa123 0x5f7 0x2f8a 0xa0b3 0x5fa 0x3185 0xa041 0x5f2 0x3380 0x9fd8 0x600 0x357b 0x9f70 0x604 0x3776 0x9f11 0x60d 0x3971 0x9ec8 0x629 0x3b6c 0x9e7f 0x651 0x3d67 0x9e11 0x64a 0x3f62 0x9d77 0x62c 0x415d 0x9cd3 0x622 0x4358 0x9c4f 0x622 0x4553 0x9be1 0x623 0x474f 0x9b99 0x630 0x494a 0x9b5b 0x655 0x4b45 0x9b1d 0x65e 0x4d40 0x9ada 0x65e 0x4f3b 0x9a7d 0x65c 0x5136 0x9a1d 0x651 0x5331 0x99b6 0x641 0x552c 0x994c 0x618 0x5727 0x98dc 0x5e2 0x5922 0x986e 0x5c0 0x5b1d 0x980a 0x5a7 0x5d18 0x97b2 0x591 0x5f13 0x9764 0x57e 0x610e 0x971d 0x56e 0x630a 0x96da 0x56e 0x6505 0x969c 0x568 0x6700 0x9664 0x564 0x68fb 0x9630 0x564 0x6af6 0x95fd 0x564 0x6cf1 0x95c9 0x564 0x6eec 0x959d 0x564 0x70e7 0x9574 0x56c 0x72e2 0x9543 0x56e 0x74dd 0x9518 0x56e 0x76d8 0x94ee 0x576 0x78d3 0x94ce 0x578 0x7ace 0x94a5 0x581 0x7cc9 0x9486 0x582 0x7ec5 0x945d 0x582 0x80c0 0x943e 0x582 0x82bb 0x941f 0x596 0x84b6 0x9400 0x596 0x86b1 0x93e2 0x596 0x88ac 0x93c4 0x597 0x8aa7 0x93ad 0x5a2 0x8ca2 0x938c 0x5a6 0x8e9d 0x9365 0x594 0x9098 0x9347 0x58a 0x9293 0x9328 0x582 0x948e 0x9309 0x582 0x9689 0x92e6 0x57f 0x9884 0x92bd 0x578 0x9a80 0x9294 0x578 0x9c7b 0x926b 0x578 0x9e76 0x9246 0x57d 0xa071 0x9227 0x587 0xa26c 0x9203 0x591 0xa467 0x91d5 0x596 0xa662 0x919b 0x59c 0xa85d 0x915d 0x5a6 0xaa58 0x9126 0x5b0 0xac53 0x90e5 0x5c1 0xae4e 0x909d 0x5c5 0xb049 0x9055 0x5bf 0xb244 0x902b 0x5cd 0xb43f 0x9014 0x5da 0xb63b 0x9008 0x605 0xb836 0x8ff5 0x628 0xba31 0x8fd7 0x658 0xbc2c 0x8f8a 0x6a8 0xbe27 0x8d60 0x6c5 0xc022 0x8467 0x84d 0xc21d 0x841c 0x85c 0xc418 0x841c 0x85c>;
		battery2_profile_t1_num = <0x64>;
		battery2_profile_t2 = <0x00 0xabcc 0xae6 0x1fb 0xaafe 0xae6 0x3f6 0xaa46 0xae4 0x5f1 0xa9ab 0xac5 0x7ec 0xa91c 0xaa6 0x9e7 0xa898 0xa86 0xbe2 0xa815 0xa62 0xddd 0xa7a1 0xa51 0xfd9 0xa728 0xa2d 0x11d4 0xa6b4 0xa18 0x13cf 0xa63c 0xa04 0x15ca 0xa5ca 0x9ec 0x17c5 0xa559 0x9cd 0x19c0 0xa4e7 0x9b6 0x1bbb 0xa476 0x9ac 0x1db6 0xa405 0x99d 0x1fb1 0xa398 0x983 0x21ac 0xa331 0x979 0x23a7 0xa2c4 0x978 0x25a2 0xa259 0x96e 0x279d 0xa1ec 0x96a 0x2998 0xa181 0x96a 0x2b94 0xa113 0x96a 0x2d8f 0xa0a8 0x963 0x2f8a 0xa042 0x951 0x3185 0x9fdb 0x954 0x3380 0x9f84 0x95e 0x357b 0x9f39 0x979 0x3776 0x9ef1 0x9aa 0x3971 0x9e98 0x9cb 0x3b6c 0x9e0d 0x9bc 0x3d67 0x9d5f 0x981 0x3f62 0x9caf 0x956 0x415d 0x9c1f 0x938 0x4358 0x9ba6 0x92d 0x4553 0x9b4a 0x91b 0x474f 0x9af8 0x925 0x494a 0x9ab1 0x92f 0x4b45 0x9a72 0x936 0x4d40 0x9a28 0x927 0x4f3b 0x99d6 0x903 0x5136 0x9980 0x8dd 0x5331 0x9923 0x8b7 0x552c 0x98c6 0x895 0x5727 0x986b 0x870 0x5922 0x9811 0x854 0x5b1d 0x97c3 0x840 0x5d18 0x977a 0x82f 0x5f13 0x9732 0x820 0x610e 0x96eb 0x811 0x630a 0x96a8 0x807 0x6505 0x966f 0x808 0x6700 0x963c 0x806 0x68fb 0x9602 0x802 0x6af6 0x95d2 0x802 0x6cf1 0x95a1 0x802 0x6eec 0x9575 0x811 0x70e7 0x954c 0x80e 0x72e2 0x9523 0x7c6 0x74dd 0x9522 0x7db 0x76d8 0x94f1 0x700 0x78d3 0x94c5 0x6cd 0x7ace 0x949b 0x6cc 0x7cc9 0x947c 0x6c3 0x7ec5 0x945d 0x6cc 0x80c0 0x943e 0x6cc 0x82bb 0x941f 0x6cc 0x84b6 0x9400 0x6d5 0x86b1 0x93e2 0x6cc 0x88ac 0x93cc 0x6cc 0x8aa7 0x93af 0x6ca 0x8ca2 0x939a 0x6bc 0x8e9d 0x938c 0x670 0x9098 0x9388 0x5cc 0x9293 0x935d 0x602 0x948e 0x9342 0x5c8 0x9689 0x9318 0x5be 0x9884 0x92ef 0x5a6 0x9a80 0x92c6 0x598 0x9c7b 0x929d 0x588 0x9e76 0x9274 0x582 0xa071 0x924a 0x582 0xa26c 0x9226 0x582 0xa467 0x9202 0x582 0xa662 0x91cd 0x57c 0xa85d 0x918f 0x572 0xaa58 0x9151 0x56e 0xac53 0x911a 0x575 0xae4e 0x90e0 0x578 0xb049 0x9093 0x571 0xb244 0x9048 0x566 0xb43f 0x9028 0x56c 0xb63b 0x9014 0x576 0xb836 0x8fff 0x581 0xba31 0x8fea 0x594 0xbc2c 0x8fd6 0x5c4 0xbe27 0x8ee4 0x5e7 0xc022 0x889a 0x632 0xc21d 0x8458 0x6b8 0xc418 0x8458 0x6b8>;
		battery2_profile_t2_num = <0x64>;
		battery2_profile_t3 = <0x00 0xabd6 0x1680 0x1fb 0xab07 0x1689 0x3f6 0xaa39 0x1773 0x5f1 0xa980 0x1711 0x7ec 0xa8d2 0x16da 0x9e7 0xa832 0x1696 0xbe2 0xa7a0 0x1659 0xddd 0xa709 0x15fb 0xfd9 0xa682 0x15bd 0x11d4 0xa5fd 0x1579 0x13cf 0xa578 0x1534 0x15ca 0xa4f5 0x1507 0x17c5 0xa479 0x14cf 0x19c0 0xa401 0x1495 0x1bbb 0xa38b 0x146b 0x1db6 0xa315 0x1455 0x1fb1 0xa29e 0x143c 0x21ac 0xa228 0x140d 0x23a7 0xa1b6 0x13e2 0x25a2 0xa146 0x13bf 0x279d 0xa0da 0x13a4 0x2998 0xa07a 0x13a2 0x2b94 0xa023 0x13c1 0x2d8f 0x9fc9 0x13e4 0x2f8a 0x9f66 0x13d6 0x3185 0x9ee0 0x13af 0x3380 0x9e47 0x1356 0x357b 0x9da4 0x12e6 0x3776 0x9cfe 0x1262 0x3971 0x9c6d 0x11f9 0x3b6c 0x9bef 0x11b7 0x3d67 0x9b7d 0x1195 0x3f62 0x9b15 0x1162 0x415d 0x9ac2 0x1145 0x4358 0x9a71 0x1158 0x4553 0x9a1f 0x1156 0x474f 0x99d5 0x1136 0x494a 0x9981 0x1111 0x4b45 0x9926 0x1106 0x4d40 0x98d4 0x10f8 0x4f3b 0x9882 0x10d7 0x5136 0x9831 0x10b5 0x5331 0x97e6 0x10ae 0x552c 0x9797 0x10a4 0x5727 0x9750 0x1089 0x5922 0x970b 0x1084 0x5b1d 0x96c9 0x1090 0x5d18 0x9689 0x108b 0x5f13 0x9651 0x1086 0x610e 0x9619 0x1090 0x630a 0x95e0 0x10aa 0x6505 0x95a7 0x10b2 0x6700 0x957a 0x10b4 0x68fb 0x954d 0x10c8 0x6af6 0x951f 0x10e2 0x6cf1 0x94f4 0x10f1 0x6eec 0x94d2 0x110a 0x70e7 0x94ac 0x1121 0x72e2 0x9492 0x1136 0x74dd 0x9476 0x115a 0x76d8 0x945f 0x118c 0x78d3 0x944a 0x11c9 0x7ace 0x9436 0x1207 0x7cc9 0x9421 0x1231 0x7ec5 0x940d 0x126e 0x80c0 0x9402 0x12c0 0x82bb 0x93ed 0x12ff 0x84b6 0x93d9 0x135b 0x86b1 0x93c4 0x13ad 0x88ac 0x93b1 0x140b 0x8aa7 0x93a5 0x146c 0x8ca2 0x938e 0x14e5 0x8e9d 0x9372 0x154e 0x9098 0x935b 0x15be 0x9293 0x933c 0x1638 0x948e 0x931d 0x16c6 0x9689 0x92fe 0x1750 0x9884 0x92df 0x17e3 0x9a80 0x92bc 0x187d 0x9c7b 0x9293 0x191c 0x9e76 0x9265 0x19cb 0xa071 0x9231 0x1a85 0xa26c 0x91fe 0x1b43 0xa467 0x91cb 0x1c10 0xa662 0x9191 0x1cf5 0xa85d 0x9153 0x1de9 0xaa58 0x9115 0x1eef 0xac53 0x90de 0x200c 0xae4e 0x90ab 0x2160 0xb049 0x9077 0x22cb 0xb244 0x9044 0x2444 0xb43f 0x9000 0x25f3 0xb63b 0x8fb0 0x27b1 0xb836 0x8f3c 0x296e 0xba31 0x8e9c 0x2b2b 0xbc2c 0x8dc8 0x2ca8 0xbe27 0x8cb6 0x2df6 0xc022 0x8b69 0x2ef7 0xc21d 0x879f 0x31f9 0xc418 0x8444 0x361a>;
		battery2_profile_t3_num = <0x64>;
		battery2_profile_t4 = <0x00 0xabc2 0x16ee 0x1fb 0xaa59 0x175e 0x3f6 0xa91d 0x239a 0x5f1 0xa81f 0x24d5 0x7ec 0xa752 0x24c4 0x9e7 0xa68f 0x2480 0xbe2 0xa5d9 0x2421 0xddd 0xa535 0x23c1 0xfd9 0xa49a 0x2373 0x11d4 0xa402 0x2319 0x13cf 0xa373 0x22c4 0x15ca 0xa2e7 0x226c 0x17c5 0xa25e 0x221b 0x19c0 0xa1dc 0x21c5 0x1bbb 0xa161 0x2176 0x1db6 0xa0f0 0x2143 0x1fb1 0xa088 0x2125 0x21ac 0xa021 0x2109 0x23a7 0x9fa7 0x20ce 0x25a2 0x9f21 0x2072 0x279d 0x9e7f 0x1fd4 0x2998 0x9dd6 0x1f21 0x2b94 0x9d31 0x1e79 0x2d8f 0x9ca2 0x1dfa 0x2f8a 0x9c1c 0x1d90 0x3185 0x9ba6 0x1d42 0x3380 0x9b46 0x1d15 0x357b 0x9ae9 0x1cf4 0x3776 0x9a96 0x1cdf 0x3971 0x9a43 0x1cd4 0x3b6c 0x99fa 0x1cc9 0x3d67 0x99a8 0x1cab 0x3f62 0x995a 0x1ca1 0x415d 0x990c 0x1c94 0x4358 0x98bb 0x1c77 0x4553 0x9870 0x1c62 0x474f 0x9820 0x1c50 0x494a 0x97d7 0x1c45 0x4b45 0x978f 0x1c3b 0x4d40 0x9746 0x1c37 0x4f3b 0x9702 0x1c37 0x5136 0x96bf 0x1c2a 0x5331 0x967b 0x1c2a 0x552c 0x9642 0x1c2f 0x5727 0x9609 0x1c39 0x5922 0x95d1 0x1c4e 0x5b1d 0x959d 0x1c5c 0x5d18 0x9569 0x1c62 0x5f13 0x953c 0x1c7a 0x610e 0x9519 0x1c9f 0x630a 0x94f3 0x1cc9 0x6505 0x94d1 0x1cfa 0x6700 0x94b2 0x1d2e 0x68fb 0x9493 0x1d61 0x6af6 0x9485 0x1d95 0x6cf1 0x9469 0x1ded 0x6eec 0x9453 0x1e2e 0x70e7 0x943f 0x1e89 0x72e2 0x942a 0x1ed2 0x74dd 0x9415 0x1f1c 0x76d8 0x9401 0x1f82 0x78d3 0x93ec 0x1fd5 0x7ace 0x93d7 0x2034 0x7cc9 0x93c3 0x209d 0x7ec5 0x93b0 0x210d 0x80c0 0x93a3 0x2179 0x82bb 0x938e 0x21f3 0x84b6 0x937a 0x2268 0x86b1 0x9365 0x22eb 0x88ac 0x9350 0x2374 0x8aa7 0x9337 0x23f4 0x8ca2 0x931d 0x247f 0x8e9d 0x9308 0x2510 0x9098 0x92ee 0x25ac 0x9293 0x92cf 0x2646 0x948e 0x92b6 0x26e7 0x9689 0x929c 0x2795 0x9884 0x927d 0x2845 0x9a80 0x9257 0x28ee 0x9c7b 0x9235 0x29a9 0x9e76 0x920e 0x2a6e 0xa071 0x91e5 0x2b32 0xa26c 0x91bb 0x2bff 0xa467 0x9192 0x2cce 0xa662 0x9160 0x2da6 0xa85d 0x912c 0x2e7f 0xaa58 0x90f8 0x2f62 0xac53 0x90c4 0x303c 0xae4e 0x9091 0x313e 0xb049 0x905d 0x3241 0xb244 0x902a 0x3345 0xb43f 0x9000 0x3454 0xb63b 0x8fca 0x3575 0xb836 0x8f8c 0x3692 0xba31 0x8f4c 0x37b0 0xbc2c 0x8ef8 0x38d1 0xbe27 0x8e7a 0x39ed 0xc022 0x8d90 0x3b36 0xc21d 0x8af5 0x3dc6 0xc418 0x849e 0x445c>;
		battery2_profile_t4_num = <0x64>;
		compatible = "mediatek,bat_gm30";
		g_FG_PSEUDO100_T0 = <0x64>;
		g_FG_PSEUDO100_T1 = <0x64>;
		g_FG_PSEUDO100_T2 = <0x64>;
		g_FG_PSEUDO100_T3 = <0x64>;
		g_FG_PSEUDO100_T4 = <0x64>;
		linux,phandle = <0x78>;
		phandle = <0x78>;
	};

	bpi_bsi_slv0@1021e000 {
		compatible = "mediatek,bpi_bsi_slv0";
		reg = <0x00 0x1021e000 0x00 0x1000>;
	};

	bpi_bsi_slv1@1021f000 {
		compatible = "mediatek,bpi_bsi_slv1";
		reg = <0x00 0x1021f000 0x00 0x6000>;
	};

	bpi_bsi_slv2@10225000 {
		compatible = "mediatek,bpi_bsi_slv2";
		reg = <0x00 0x10225000 0x00 0x1000>;
	};

	btif@1100c000 {
		clock-names = "btifc\0apdmac";
		clocks = <0x24 0x1a 0x24 0x26>;
		compatible = "mediatek,btif";
		interrupts = <0x00 0x70 0x08 0x00 0x84 0x08 0x00 0x85 0x08>;
		reg = <0x00 0x1100c000 0x00 0x1000 0x00 0x11000880 0x00 0x80 0x00 0x11000900 0x00 0x80>;
	};

	bus_dbg@10208000 {
		compatible = "mediatek,bus_dbg-v2";
		interrupts = <0x00 0x8d 0x08>;
		mediatek,bus_dbg_con_offset = <0x2fc>;
		reg = <0x00 0x10208000 0x00 0x1000 0x00 0x10001000 0x00 0x1000>;
	};

	cam1@1a003000 {
		compatible = "mediatek,cam1";
		interrupts = <0x00 0xeb 0x08>;
		reg = <0x00 0x1a003000 0x00 0x1000>;
	};

	cam2@1a004000 {
		compatible = "mediatek,cam2";
		interrupts = <0x00 0xec 0x08>;
		reg = <0x00 0x1a004000 0x00 0x1000>;
	};

	cam3@1a005000 {
		compatible = "mediatek,cam3";
		interrupts = <0x00 0xed 0x08>;
		reg = <0x00 0x1a005000 0x00 0x1000>;
	};

	cam_clear@1a01b000 {
		compatible = "mediatek,cam_clear";
		reg = <0x00 0x1a01b000 0x00 0x1000>;
	};

	cam_inner@1a013000 {
		compatible = "mediatek,cam_inner";
		reg = <0x00 0x1a013000 0x00 0x1000>;
	};

	cam_set@1a00b000 {
		compatible = "mediatek,cam_set";
		reg = <0x00 0x1a00b000 0x00 0x1000>;
	};

	cama_clear@1a01c000 {
		compatible = "mediatek,cama_clear";
		reg = <0x00 0x1a01c000 0x00 0x1000>;
	};

	cama_ext@1a024000 {
		compatible = "mediatek,cama_ext";
		reg = <0x00 0x1a024000 0x00 0x1000>;
	};

	cama_inner@1a014000 {
		compatible = "mediatek,cama_inner";
		reg = <0x00 0x1a014000 0x00 0x1000>;
	};

	cama_set@1a00c000 {
		compatible = "mediatek,cama_set";
		reg = <0x00 0x1a00c000 0x00 0x1000>;
	};

	camb_clear@1a01d000 {
		compatible = "mediatek,camb_clear";
		reg = <0x00 0x1a01d000 0x00 0x1000>;
	};

	camb_ext@1a025000 {
		compatible = "mediatek,camb_ext";
		reg = <0x00 0x1a025000 0x00 0x1000>;
	};

	camb_inner@1a015000 {
		compatible = "mediatek,camb_inner";
		reg = <0x00 0x1a015000 0x00 0x1000>;
	};

	camb_set@1a00d000 {
		compatible = "mediatek,camb_set";
		reg = <0x00 0x1a00d000 0x00 0x1000>;
	};

	camsv1@1a050000 {
		compatible = "mediatek,camsv1";
		interrupts = <0x00 0xf3 0x08>;
		reg = <0x00 0x1a050000 0x00 0x1000>;
	};

	camsv2@1a051000 {
		compatible = "mediatek,camsv2";
		interrupts = <0x00 0xf4 0x08>;
		reg = <0x00 0x1a051000 0x00 0x1000>;
	};

	camsv3@1a052000 {
		compatible = "mediatek,camsv3";
		interrupts = <0x00 0xf1 0x08>;
		reg = <0x00 0x1a052000 0x00 0x1000>;
	};

	camsv4@1a053000 {
		compatible = "mediatek,camsv4";
		interrupts = <0x00 0xf2 0x08>;
		reg = <0x00 0x1a053000 0x00 0x1000>;
	};

	camsys@1a000000 {
		#clock-cells = <0x01>;
		compatible = "mediatek,camsys\0syscon";
		linux,phandle = <0x43>;
		phandle = <0x43>;
		reg = <0x00 0x1a000000 0x00 0x1000>;
	};

	ccu@1a0b0000 {
		clock-names = "CCU_CLK_CAM_CCU";
		clocks = <0x43 0x08>;
		compatible = "mediatek,ccu";
		interrupts = <0x00 0xf6 0x08>;
		reg = <0x00 0x1a0b1000 0x00 0x1000>;
	};

	charger {
		ac_charger_current = <0x1cafc0>;
		ac_charger_input_current = <0x1cafc0>;
		algorithm_name = "LinearCharging";
		apple_1_0a_charger_current = <0x9eb10>;
		apple_2_1a_charger_current = "\0\f5";
		battery_cv = <0x432380>;
		bif_cv_under_threshold2 = <0x43e6d0>;
		bif_threshold1 = <0x40d990>;
		bif_threshold2 = <0x419ce0>;
		cable_imp_threshold = <0x2bb>;
		charging_host_charger_current = <0xf4240>;
		chg1_ta_ac_charger_current = <0x16e360>;
		chg2_ta_ac_charger_current = <0x16e360>;
		chg_full_current = <0x30d40>;
		compatible = "mediatek,charger";
		disable_pd_dual;
		dual_polling_ieoc = <0x6ddd0>;
		enable_dynamic_mivr;
		enable_min_charge_temp;
		enable_sw_jeita;
		enable_sw_safety_timer;
		high_temp_to_enter_pe40 = <0x27>;
		high_temp_to_leave_pe40 = <0x2e>;
		ibus_err = <0x0e>;
		jeita_temp_above_t4_cv = <0x3e8fa0>;
		jeita_temp_below_t0_cv = <0x432380>;
		jeita_temp_t0_to_t1_cv = <0x432380>;
		jeita_temp_t1_to_t2_cv = <0x432380>;
		jeita_temp_t2_to_t3_cv = <0x432380>;
		jeita_temp_t3_to_t4_cv = <0x3e8fa0>;
		linux,phandle = <0x9e>;
		low_temp_to_enter_pe40 = <0x10>;
		low_temp_to_leave_pe40 = <0x0a>;
		max_charge_temp = <0x35>;
		max_charge_temp_minus_x_degree = <0x34>;
		max_charger_voltage = <0x632ea0>;
		max_charging_time = <0xa8c0>;
		max_dmivr_charger_current = <0x155cc0>;
		min_charge_temp = <0x00>;
		min_charge_temp_plus_x_degree = <0x01>;
		min_charger_voltage = <0x4630c0>;
		min_charger_voltage_1 = <0x432380>;
		min_charger_voltage_2 = <0x401640>;
		non_std_ac_charger_current = <0x7a120>;
		pd_ichg_level_threshold = <0xf4240>;
		pd_stop_battery_soc = <0x50>;
		pd_vbus_low_bound = <0x4c4b40>;
		pd_vbus_upper_bound = <0x4c4b40>;
		pe20_ichg_level_threshold = <0xf4240>;
		pe40_dual_charger_chg1_current = <0x1e8480>;
		pe40_dual_charger_chg2_current = <0x1e8480>;
		pe40_dual_charger_input_current = <0x2dc6c0>;
		pe40_r_cable_1a_lower = <0x229>;
		pe40_r_cable_2a_lower = <0x19f>;
		pe40_r_cable_3a_lower = <0x113>;
		pe40_single_charger_current = <0x2dc6c0>;
		pe40_single_charger_input_current = <0x2dc6c0>;
		pe40_stop_battery_soc = <0x50>;
		pe_ichg_level_threshold = <0xf4240>;
		phandle = <0x9e>;
		recharge_offset = <0x186a0>;
		slave_mivr_diff = <0x186a0>;
		ta_12v_support;
		ta_9v_support;
		ta_ac_12v_input_current = <0x30d400>;
		ta_ac_7v_input_current = <0x30d400>;
		ta_ac_9v_input_current = <0x30d400>;
		ta_ac_charger_current = <0x2dc6c0>;
		ta_start_battery_soc = <0x00>;
		ta_stop_battery_soc = <0x55>;
		temp_neg_10_thres = <0x02>;
		temp_t0_thres = <0x01>;
		temp_t0_thres_plus_x_degree = <0x01>;
		temp_t1_thres = <0x01>;
		temp_t1_thres_plus_x_degree = <0x01>;
		temp_t2_thres = <0x0f>;
		temp_t2_thres_plus_x_degree = <0x10>;
		temp_t3_thres = <0x2d>;
		temp_t3_thres_minus_x_degree = <0x2c>;
		temp_t4_thres = <0x37>;
		temp_t4_thres_minus_x_degree = <0x33>;
		topoff_voltage = <0x401640>;
		usb_charger_current = <0x7ef40>;
		usb_charger_current_configured = <0x7ef40>;
		usb_charger_current_suspend = <0x00>;
		usb_charger_current_unconfigured = <0x11170>;
		vbat_cable_imp_threshold = <0x3b8260>;
		vsys_watt = <0x4c4b40>;
	};

	chipid@08000000 {
		compatible = "mediatek,chipid";
		reg = <0x00 0x8000000 0x00 0x04 0x00 0x8000004 0x00 0x04 0x00 0x8000008 0x00 0x04 0x00 0x800000c 0x00 0x04>;
	};

	chosen {
		bootargs = "console=tty0 console=ttyS0,921600n1 vmalloc=400M slub_debug=OFZPU page_owner=on swiotlb=noforce androidboot.hardware=mt6765 maxcpus=8 loop.max_part=7 firmware_class.path=/vendor/firmware";
		kaslr-seed = <0x00 0x00>;
		linux,phandle = <0x4c>;
		phandle = <0x4c>;
	};

	clocks {

		clk26m {
			#clock-cells = <0x00>;
			clock-frequency = <0x18cba80>;
			compatible = "fixed-clock";
			linux,phandle = <0x1f>;
			phandle = <0x1f>;
		};

		clk32k {
			#clock-cells = <0x00>;
			clock-frequency = <0x7d00>;
			compatible = "fixed-clock";
			linux,phandle = <0x1d>;
			phandle = <0x1d>;
		};
	};

	consys@18002000 {
		#address-cells = <0x02>;
		#size-cells = <0x02>;
		clock-names = "conn";
		clocks = <0x25 0x01>;
		compatible = "mediatek,mt6765-consys";
		interrupts = <0x00 0x10b 0x08 0x00 0x10d 0x08 0x00 0x10e 0x01>;
		linux,phandle = <0x1b>;
		phandle = <0x1b>;
		reg = <0x00 0x18002000 0x00 0x1000 0x00 0x10007000 0x00 0x100 0x00 0x10001000 0x00 0x1000 0x00 0x10006000 0x00 0x1000 0x00 0x18007000 0x00 0x1000 0x00 0x180b1000 0x00 0x1000 0x00 0x180a3000 0x00 0x1000 0x00 0x180a5000 0x00 0x800 0x00 0x180c1000 0x00 0x1000 0x00 0x18004000 0x00 0x1000 0x00 0x00 0x00 0x00 0x00 0x00 0x00 0x00 0x00 0x1020e000 0x00 0x1000>;
	};

	cpu_dbgapb@0d410000 {
		compatible = "mediatek,hw_dbg";
		linux,phandle = <0x4e>;
		num = <0x08>;
		phandle = <0x4e>;
		reg = <0x00 0xd410000 0x00 0x1000 0x00 0xd510000 0x00 0x1000 0x00 0xd610000 0x00 0x1000 0x00 0xd710000 0x00 0x1000 0x00 0xd810000 0x00 0x1000 0x00 0xd910000 0x00 0x1000 0x00 0xda10000 0x00 0x1000 0x00 0xdb10000 0x00 0x1000>;
	};

	cpus {
		#address-cells = <0x01>;
		#size-cells = <0x00>;

		cpu-map {

			cluster0 {

				core0 {
					cpu = <0x09>;
				};

				core1 {
					cpu = <0x0a>;
				};

				core2 {
					cpu = <0x0b>;
				};

				core3 {
					cpu = <0x0c>;
				};
			};

			cluster1 {

				core0 {
					cpu = <0x0d>;
				};

				core1 {
					cpu = <0x0e>;
				};

				core2 {
					cpu = <0x0f>;
				};

				core3 {
					cpu = <0x10>;
				};
			};
		};

		cpu@000 {
			clock-frequency = <0x89267940>;
			compatible = "arm,cortex-a53";
			cpu-idle-states = <0x02 0x03 0x04 0x05 0x06 0x07 0x08>;
			device_type = "cpu";
			enable-method = "psci";
			linux,phandle = <0x09>;
			phandle = <0x09>;
			reg = <0x00>;
		};

		cpu@001 {
			clock-frequency = <0x89267940>;
			compatible = "arm,cortex-a53";
			cpu-idle-states = <0x02 0x03 0x04 0x05 0x06 0x07 0x08>;
			device_type = "cpu";
			enable-method = "psci";
			linux,phandle = <0x0a>;
			phandle = <0x0a>;
			reg = <0x01>;
		};

		cpu@002 {
			clock-frequency = <0x89267940>;
			compatible = "arm,cortex-a53";
			cpu-idle-states = <0x02 0x03 0x04 0x05 0x06 0x07 0x08>;
			device_type = "cpu";
			enable-method = "psci";
			linux,phandle = <0x0b>;
			phandle = <0x0b>;
			reg = <0x02>;
		};

		cpu@003 {
			clock-frequency = <0x89267940>;
			compatible = "arm,cortex-a53";
			cpu-idle-states = <0x02 0x03 0x04 0x05 0x06 0x07 0x08>;
			device_type = "cpu";
			enable-method = "psci";
			linux,phandle = <0x0c>;
			phandle = <0x0c>;
			reg = <0x03>;
		};

		cpu@100 {
			clock-frequency = <0x6b49d200>;
			compatible = "arm,cortex-a53";
			cpu-idle-states = <0x02 0x03 0x04 0x05 0x06 0x07 0x08>;
			device_type = "cpu";
			enable-method = "psci";
			linux,phandle = <0x0d>;
			phandle = <0x0d>;
			reg = <0x100>;
		};

		cpu@101 {
			clock-frequency = <0x6b49d200>;
			compatible = "arm,cortex-a53";
			cpu-idle-states = <0x02 0x03 0x04 0x05 0x06 0x07 0x08>;
			device_type = "cpu";
			enable-method = "psci";
			linux,phandle = <0x0e>;
			phandle = <0x0e>;
			reg = <0x101>;
		};

		cpu@102 {
			clock-frequency = <0x6b49d200>;
			compatible = "arm,cortex-a53";
			cpu-idle-states = <0x02 0x03 0x04 0x05 0x06 0x07 0x08>;
			device_type = "cpu";
			enable-method = "psci";
			linux,phandle = <0x0f>;
			phandle = <0x0f>;
			reg = <0x102>;
		};

		cpu@103 {
			clock-frequency = <0x6b49d200>;
			compatible = "arm,cortex-a53";
			cpu-idle-states = <0x02 0x03 0x04 0x05 0x06 0x07 0x08>;
			device_type = "cpu";
			enable-method = "psci";
			linux,phandle = <0x10>;
			phandle = <0x10>;
			reg = <0x103>;
		};

		idle-states {
			entry-method = "arm,psci";

			dpidle {
				arm,psci-suspend-param = <0x1010004>;
				compatible = "arm,idle-state";
				entry-latency-us = <0x320>;
				exit-latency-us = <0x3e8>;
				linux,phandle = <0x07>;
				min-residency-us = <0x7d0>;
				phandle = <0x07>;
			};

			mcdi-cluster {
				arm,psci-suspend-param = <0x1010001>;
				compatible = "arm,idle-state";
				entry-latency-us = <0x258>;
				exit-latency-us = <0x258>;
				linux,phandle = <0x04>;
				min-residency-us = <0x4b0>;
				phandle = <0x04>;
			};

			mcdi-cpu {
				arm,psci-suspend-param = <0x10001>;
				compatible = "arm,idle-state";
				entry-latency-us = <0x258>;
				exit-latency-us = <0x258>;
				linux,phandle = <0x03>;
				min-residency-us = <0x4b0>;
				phandle = <0x03>;
			};

			sodi {
				arm,psci-suspend-param = <0x1010002>;
				compatible = "arm,idle-state";
				entry-latency-us = <0x320>;
				exit-latency-us = <0x3e8>;
				linux,phandle = <0x05>;
				min-residency-us = <0x7d0>;
				phandle = <0x05>;
			};

			sodi3 {
				arm,psci-suspend-param = <0x1010003>;
				compatible = "arm,idle-state";
				entry-latency-us = <0x320>;
				exit-latency-us = <0x3e8>;
				linux,phandle = <0x06>;
				min-residency-us = <0x7d0>;
				phandle = <0x06>;
			};

			standby {
				arm,psci-suspend-param = <0x01>;
				compatible = "arm,idle-state";
				entry-latency-us = <0x258>;
				exit-latency-us = <0x258>;
				linux,phandle = <0x02>;
				min-residency-us = <0x4b0>;
				phandle = <0x02>;
			};

			suspend {
				arm,psci-suspend-param = <0x1010005>;
				compatible = "arm,idle-state";
				entry-latency-us = <0x320>;
				exit-latency-us = <0x3e8>;
				linux,phandle = <0x08>;
				min-residency-us = <0x7d0>;
				phandle = <0x08>;
			};
		};
	};

	cq_dma@10212000 {
		clock-names = "cqdma";
		clocks = <0x24 0x43>;
		compatible = "mediatek,mt-cqdma-v1";
		interrupts = <0x00 0x71 0x08 0x00 0x72 0x08>;
		keep_clock_ao = "yes";
		nr_channel = <0x02>;
		reg = <0x00 0x10212000 0x00 0x80 0x00 0x10212080 0x00 0x80>;
	};

	dbg_apmcu_mp0@0d400000 {
		compatible = "mediatek,dbg_apmcu_mp0";
		reg = <0x00 0xd400000 0x00 0x1000>;
	};

	dbg_apmcu_mp0@0d410000 {
		compatible = "mediatek,dbg_apmcu_mp0";
		reg = <0x00 0xd410000 0x00 0x1000>;
	};

	dbg_apmcu_mp0@0d420000 {
		compatible = "mediatek,dbg_apmcu_mp0";
		reg = <0x00 0xd420000 0x00 0x1000>;
	};

	dbg_apmcu_mp0@0d430000 {
		compatible = "mediatek,dbg_apmcu_mp0";
		reg = <0x00 0xd430000 0x00 0x1000>;
	};

	dbg_apmcu_mp0@0d440000 {
		compatible = "mediatek,dbg_apmcu_mp0";
		reg = <0x00 0xd440000 0x00 0x1000>;
	};

	dbg_apmcu_mp0@0d510000 {
		compatible = "mediatek,dbg_apmcu_mp0";
		reg = <0x00 0xd510000 0x00 0x1000>;
	};

	dbg_apmcu_mp0@0d520000 {
		compatible = "mediatek,dbg_apmcu_mp0";
		reg = <0x00 0xd520000 0x00 0x1000>;
	};

	dbg_apmcu_mp0@0d530000 {
		compatible = "mediatek,dbg_apmcu_mp0";
		reg = <0x00 0xd530000 0x00 0x1000>;
	};

	dbg_apmcu_mp0@0d540000 {
		compatible = "mediatek,dbg_apmcu_mp0";
		reg = <0x00 0xd540000 0x00 0x1000>;
	};

	dbg_apmcu_mp0@0d610000 {
		compatible = "mediatek,dbg_apmcu_mp0";
		reg = <0x00 0xd610000 0x00 0x1000>;
	};

	dbg_apmcu_mp0@0d620000 {
		compatible = "mediatek,dbg_apmcu_mp0";
		reg = <0x00 0xd620000 0x00 0x1000>;
	};

	dbg_apmcu_mp0@0d630000 {
		compatible = "mediatek,dbg_apmcu_mp0";
		reg = <0x00 0xd630000 0x00 0x1000>;
	};

	dbg_apmcu_mp0@0d640000 {
		compatible = "mediatek,dbg_apmcu_mp0";
		reg = <0x00 0xd640000 0x00 0x1000>;
	};

	dbg_apmcu_mp0@0d710000 {
		compatible = "mediatek,dbg_apmcu_mp0";
		reg = <0x00 0xd710000 0x00 0x1000>;
	};

	dbg_apmcu_mp0@0d720000 {
		compatible = "mediatek,dbg_apmcu_mp0";
		reg = <0x00 0xd720000 0x00 0x1000>;
	};

	dbg_apmcu_mp0@0d730000 {
		compatible = "mediatek,dbg_apmcu_mp0";
		reg = <0x00 0xd730000 0x00 0x1000>;
	};

	dbg_apmcu_mp0@0d740000 {
		compatible = "mediatek,dbg_apmcu_mp0";
		reg = <0x00 0xd740000 0x00 0x1000>;
	};

	dbg_apmcu_mp1@0d800000 {
		compatible = "mediatek,dbg_apmcu_mp1";
		reg = <0x00 0xd800000 0x00 0x1000>;
	};

	dbg_apmcu_mp1@0d810000 {
		compatible = "mediatek,dbg_apmcu_mp1";
		reg = <0x00 0xd810000 0x00 0x1000>;
	};

	dbg_apmcu_mp1@0d820000 {
		compatible = "mediatek,dbg_apmcu_mp1";
		reg = <0x00 0xd820000 0x00 0x1000>;
	};

	dbg_apmcu_mp1@0d830000 {
		compatible = "mediatek,dbg_apmcu_mp1";
		reg = <0x00 0xd830000 0x00 0x1000>;
	};

	dbg_apmcu_mp1@0d840000 {
		compatible = "mediatek,dbg_apmcu_mp1";
		reg = <0x00 0xd840000 0x00 0x1000>;
	};

	dbg_apmcu_mp1@0d910000 {
		compatible = "mediatek,dbg_apmcu_mp1";
		reg = <0x00 0xd910000 0x00 0x1000>;
	};

	dbg_apmcu_mp1@0d920000 {
		compatible = "mediatek,dbg_apmcu_mp1";
		reg = <0x00 0xd920000 0x00 0x1000>;
	};

	dbg_apmcu_mp1@0d930000 {
		compatible = "mediatek,dbg_apmcu_mp1";
		reg = <0x00 0xd930000 0x00 0x1000>;
	};

	dbg_apmcu_mp1@0d940000 {
		compatible = "mediatek,dbg_apmcu_mp1";
		reg = <0x00 0xd940000 0x00 0x1000>;
	};

	dbg_apmcu_mp1@0da10000 {
		compatible = "mediatek,dbg_apmcu_mp1";
		reg = <0x00 0xda10000 0x00 0x1000>;
	};

	dbg_apmcu_mp1@0da20000 {
		compatible = "mediatek,dbg_apmcu_mp1";
		reg = <0x00 0xda20000 0x00 0x1000>;
	};

	dbg_apmcu_mp1@0da30000 {
		compatible = "mediatek,dbg_apmcu_mp1";
		reg = <0x00 0xda30000 0x00 0x1000>;
	};

	dbg_apmcu_mp1@0da40000 {
		compatible = "mediatek,dbg_apmcu_mp1";
		reg = <0x00 0xda40000 0x00 0x1000>;
	};

	dbg_apmcu_mp1@0db10000 {
		compatible = "mediatek,dbg_apmcu_mp1";
		reg = <0x00 0xdb10000 0x00 0x1000>;
	};

	dbg_apmcu_mp1@0db20000 {
		compatible = "mediatek,dbg_apmcu_mp1";
		reg = <0x00 0xdb20000 0x00 0x1000>;
	};

	dbg_apmcu_mp1@0db30000 {
		compatible = "mediatek,dbg_apmcu_mp1";
		reg = <0x00 0xdb30000 0x00 0x1000>;
	};

	dbg_apmcu_mp1@0db40000 {
		compatible = "mediatek,dbg_apmcu_mp1";
		reg = <0x00 0xdb40000 0x00 0x1000>;
	};

	dbg_cti@0d020000 {
		compatible = "mediatek,dbg_cti";
		reg = <0x00 0xd020000 0x00 0x10000>;
	};

	dbg_dem@0d0a0000 {
		compatible = "mediatek,dbg_dem";
		interrupts = <0x00 0x8c 0x08>;
		reg = <0x00 0xd0a0000 0x00 0x10000>;
	};

	dbg_etr@0d030000 {
		compatible = "mediatek,dbg_etr";
		reg = <0x00 0xd030000 0x00 0x10000>;
	};

	dbg_funnel@0d040000 {
		compatible = "mediatek,dbg_funnel";
		reg = <0x00 0xd040000 0x00 0x10000>;
	};

	dbg_mdsys1@0d0c0000 {
		compatible = "mediatek,dbg_mdsys1";
		reg = <0x00 0xd0c0000 0x00 0x40000>;
	};

	ddrphy@10015000 {
		compatible = "mediatek,ddrphy";
		reg = <0x00 0x10015000 0x00 0x1000>;
	};

	ddrphy@1001e000 {
		compatible = "mediatek,ddrphy";
		reg = <0x00 0x1001e000 0x00 0x1000>;
	};

	devapc@10207000 {
		clock-names = "devapc-infra-clock";
		clocks = <0x24 0x28>;
		compatible = "mediatek,devapc";
		interrupts = <0x00 0x8e 0x08>;
		reg = <0x00 0x10207000 0x00 0x1000 0x00 0x1000e000 0x00 0x1000>;
	};

	dfd@10200b00 {
		compatible = "mediatek,dfd";
		mediatek,chain_length = <0xc350>;
		mediatek,enabled = <0x01>;
		mediatek,rg_dfd_timeout = <0xa0>;
		reg = <0x00 0x10200b00 0x00 0x10000>;
	};

	dip1@15022000 {
		compatible = "mediatek,dip1";
		interrupts = <0x00 0xff 0x08>;
		reg = <0x00 0x15022000 0x00 0x3000>;
	};

	disp_aal0@14011000 {
		compatible = "mediatek,disp_aal0";
		interrupts = <0x00 0xde 0x08>;
		reg = <0x00 0x14011000 0x00 0x1000>;
	};

	disp_ccorr0@14010000 {
		compatible = "mediatek,disp_ccorr0";
		interrupts = <0x00 0xdd 0x08>;
		reg = <0x00 0x14010000 0x00 0x1000>;
	};

	disp_color0@1400f000 {
		clock-names = "MDP_COLOR";
		clocks = <0x26 0x0c>;
		compatible = "mediatek,disp_color0";
		interrupts = <0x00 0xdc 0x08>;
		linux,phandle = <0x2d>;
		phandle = <0x2d>;
		reg = <0x00 0x1400f000 0x00 0x1000>;
	};

	disp_dither0@14013000 {
		compatible = "mediatek,disp_dither0";
		interrupts = <0x00 0xe0 0x08>;
		reg = <0x00 0x14013000 0x00 0x1000>;
	};

	disp_gamma0@14012000 {
		compatible = "mediatek,disp_gamma0";
		interrupts = <0x00 0xdf 0x08>;
		reg = <0x00 0x14012000 0x00 0x1000>;
	};

	disp_mutex0@14001000 {
		compatible = "mediatek,disp_mutex0";
		interrupts = <0x00 0xd2 0x08>;
		linux,phandle = <0x2f>;
		phandle = <0x2f>;
		reg = <0x00 0x14001000 0x00 0x1000>;
	};

	disp_ovl0@1400b000 {
		compatible = "mediatek,disp_ovl0";
		interrupts = <0x00 0xd9 0x08>;
		reg = <0x00 0x1400b000 0x00 0x1000>;
	};

	disp_ovl0_2l@1400c000 {
		compatible = "mediatek,disp_ovl0_2l";
		interrupts = <0x00 0xe5 0x08>;
		reg = <0x00 0x1400c000 0x00 0x1000>;
	};

	disp_pwm@1100e000 {
		compatible = "mediatek,disp_pwm";
		reg = <0x00 0x1100e000 0x00 0x1000>;
	};

	disp_rdma0@1400d000 {
		compatible = "mediatek,disp_rdma0";
		interrupts = <0x00 0xda 0x08>;
		reg = <0x00 0x1400d000 0x00 0x1000>;
	};

	disp_rsz0@14015000 {
		compatible = "mediatek,disp_rsz0";
		interrupts = <0x00 0x114 0x08>;
		reg = <0x00 0x14015000 0x00 0x1000>;
	};

	disp_wdma0@1400e000 {
		compatible = "mediatek,disp_wdma0";
		interrupts = <0x00 0xdb 0x08>;
		reg = <0x00 0x1400e000 0x00 0x1000>;
	};

	dispsys {
		clock-names = "MMSYS_MTCMOS\0MMSYS_SMI_COMMON\0MMSYS_SMI_LARB0\0MMSYS_GALS_COMM0\0MMSYS_GALS_COMM1\0MMSYS_DISP_OVL0\0MMSYS_DISP_OVL0_2L\0MMSYS_DISP_RDMA0\0MMSYS_DISP_WDMA0\0MMSYS_DISP_COLOR0\0MMSYS_DISP_CCORR0\0MMSYS_DISP_AAL0\0MMSYS_DISP_GAMMA0\0MMSYS_DISP_DITHER0\0MMSYS_DSI0_MM_CK\0MMSYS_DSI0_IF_CK\0MMSYS_26M\0MMSYS_DISP_RSZ0\0APMIXED_MIPI_26M\0TOP_MUX_DISP_PWM\0DISP_PWM\0TOP_26M\0TOP_UNIVPLL2_D4\0TOP_ULPOSC1_D2\0TOP_ULPOSC1_D8";
		clocks = <0x25 0x03 0x26 0x13 0x26 0x14 0x26 0x15 0x26 0x16 0x26 0x07 0x26 0x08 0x26 0x0a 0x26 0x0b 0x26 0x0c 0x26 0x0d 0x26 0x0e 0x26 0x0f 0x26 0x10 0x26 0x11 0x26 0x1c 0x26 0x1d 0x26 0x09 0x41 0x15 0x1e 0x73 0x24 0x31 0x1f 0x1e 0x1b 0x1e 0x2e 0x1e 0x30>;
		compatible = "mediatek,dispsys";
		mediatek,larb = <0x20>;
	};

	dma-controller@11000580 {
		#dma-cells = <0x01>;
		clock-names = "apdma";
		clocks = <0x24 0x26>;
		compatible = "mediatek,mt6577-uart-dma";
		interrupts = <0x00 0x6d 0x08 0x00 0x6e 0x08 0x00 0x6f 0x08 0x00 0x74 0x08>;
		linux,phandle = <0x31>;
		phandle = <0x31>;
		reg = <0x00 0x11000680 0x00 0x80 0x00 0x11000700 0x00 0x80 0x00 0x11000780 0x00 0x80 0x00 0x11000800 0x00 0x80>;
	};

	dpe@15028000 {
		clock-names = "DPE_CG_IMG_DPE";
		clocks = <0x42 0x03>;
		compatible = "mediatek,dpe";
		interrupts = <0x00 0x100 0x08>;
		reg = <0x00 0x15028000 0x00 0x1000>;
	};

	dramc0@1001d000 {
		compatible = "mediatek,dramc0";
		reg = <0x00 0x1001d000 0x00 0x1000>;
	};

	dramc@1022a000 {
		compatible = "mediatek,dramc";
		reg = <0x00 0x1022a000 0x00 0x2000 0x00 0x10232000 0x00 0x2000 0x00 0x1022c000 0x00 0x1000 0x00 0x10234000 0x00 0x1000 0x00 0x10228000 0x00 0x2000 0x00 0x10230000 0x00 0x2000 0x00 0x1022e000 0x00 0x1000 0x00 0x10236000 0x00 0x1000>;
	};

	dramc_nao@1021d000 {
		compatible = "mediatek,dramc_nao";
		reg = <0x00 0x1021d000 0x00 0x1000>;
	};

	dsi0@14014000 {
		compatible = "mediatek,dsi0";
		interrupts = <0x00 0xe1 0x08>;
		reg = <0x00 0x14014000 0x00 0x1000>;
	};

	dsi_te {
		compatible = "mediatek, DSI_TE-eint";
		linux,phandle = <0x97>;
		phandle = <0x97>;
		status = "disabled";
	};

	dvfsp@00110800 {
		compatible = "mediatek,mt6765-dvfsp";
		reg = <0x00 0x110800 0x00 0x1400 0x00 0x110800 0x00 0x1400>;
	};

	dvfsp@10227000 {
		compatible = "mediatek,dvfsp";
		reg = <0x00 0x10227000 0x00 0x1000>;
	};

	dvfsrc@10012000 {
		compatible = "mediatek,dvfsrc";
		reg = <0x00 0x10012000 0x00 0x1000 0x00 0x110780 0x00 0x80>;
	};

	dxcc_sec@10210000 {
		compatible = "mediatek,dxcc_sec";
		interrupts = <0x00 0xa2 0x04>;
		reg = <0x00 0x10210000 0x00 0x1000>;
	};

	dynamic_options {
		compatible = "mediatek,dynamic_options";
		linux,phandle = <0xab>;
		phandle = <0xab>;
	};

	eas {
		eff_turn_point = <0x1d3>;
		tiny = <0x32>;
	};

	eem_fsm@1100b000 {
		compatible = "mediatek,eem_fsm";
		interrupts = <0x00 0x7d 0x08>;
		reg = <0x00 0x1100b000 0x00 0x1000>;
	};

	efuse_dbg@10004000 {
		compatible = "mediatek,efuse_dbg";
		reg = <0x00 0x10004000 0x00 0x1000>;
	};

	efusec@11c50000 {
		compatible = "mediatek,efusec";
		reg = <0x00 0x11c50000 0x00 0x10000>;
	};

	emi@10219000 {
		compatible = "mediatek,emi";
		interrupts = <0x00 0x90 0x08>;
		reg = <0x00 0x10219000 0x00 0x1000 0x00 0x10226000 0x00 0x1000 0x00 0x1022d000 0x00 0x1000 0x00 0x10235000 0x00 0x1000>;
	};

	fdvt@1502b000 {
		clock-names = "FD_CLK_IMG_FDVT";
		clocks = <0x42 0x02>;
		compatible = "mediatek,fdvt";
		interrupts = <0x00 0x102 0x08>;
		reg = <0x00 0x1502b000 0x00 0x1000>;
	};

	fhctl@1000ce00 {
		compatible = "mediatek,fhctl";
		reg = <0x00 0x1000ce00 0x00 0x200>;
	};

	fingerprint {
		compatible = "mediatek,goodix-fp";
		linux,phandle = <0x77>;
		phandle = <0x77>;
	};

	flashlight_core {
		compatible = "mediatek,flashlight_core";
		linux,phandle = <0x99>;
		phandle = <0x99>;
	};

	flashlights_aw3644 {
		compatible = "mediatek,flashlights_aw3644";
		linux,phandle = <0x9b>;
		phandle = <0x9b>;
	};

	flashlights_mt6370 {
		compatible = "mediatek,flashlights_mt6370";
		decouple = <0x00>;
		linux,phandle = <0x9a>;
		phandle = <0x9a>;

		channel@1 {
			ct = <0x00>;
			part = <0x00>;
			type = <0x00>;
		};

		channel@2 {
			ct = <0x01>;
			part = <0x00>;
			type = <0x00>;
		};
	};

	gauge_timer {
		compatible = "mediatek,gauge_timer_service";
	};

	gce@10238000 {
		#clock-cells = <0x01>;
		ap_dma_base = <0x18010000 0x17 0xffff0000>;
		audio_base = <0x17000000 0x12 0xffff0000>;
		buf_underrun_event_0 = <0x8c>;
		camsys1_base = <0x180a0000 0x1c 0xffff0000>;
		camsys2_base = <0x180b0000 0x1d 0xffff0000>;
		camsys_base = <0x18080000 0x1b 0xffff0000>;
		clock-names = "GCE\0GCE_TIMER";
		clocks = <0x24 0x09 0x24 0x18>;
		compatible = "mediatek,gce\0syscon";
		conn_peri_base = <0x18820000 0x07 0xffff0000>;
		dip_cq_thread0_frame_done = <0x101>;
		dip_cq_thread10_frame_done = <0x10b>;
		dip_cq_thread11_frame_done = <0x10c>;
		dip_cq_thread12_frame_done = <0x10d>;
		dip_cq_thread13_frame_done = <0x10e>;
		dip_cq_thread14_frame_done = <0x10f>;
		dip_cq_thread15_frame_done = <0x110>;
		dip_cq_thread16_frame_done = <0x111>;
		dip_cq_thread17_frame_done = <0x112>;
		dip_cq_thread18_frame_done = <0x113>;
		dip_cq_thread1_frame_done = <0x102>;
		dip_cq_thread2_frame_done = <0x103>;
		dip_cq_thread3_frame_done = <0x104>;
		dip_cq_thread4_frame_done = <0x105>;
		dip_cq_thread5_frame_done = <0x106>;
		dip_cq_thread6_frame_done = <0x107>;
		dip_cq_thread7_frame_done = <0x108>;
		dip_cq_thread8_frame_done = <0x109>;
		dip_cq_thread9_frame_done = <0x10a>;
		disp_2l_ovl0_frame_done = <0x1c>;
		disp_2l_ovl0_sof = <0x08>;
		disp_aal0_frame_done = <0x22>;
		disp_aal0_sof = <0x0d>;
		disp_ccorr0_frame_done = <0x21>;
		disp_ccorr0_sof = <0x0c>;
		disp_color0_frame_done = <0x20>;
		disp_color0_sof = <0x0b>;
		disp_dither0_frame_done = <0x24>;
		disp_dither0_sof = <0x0f>;
		disp_dither_base = <0x14010000 0x02 0xffff0000>;
		disp_dsi0_frame_done = <0x25>;
		disp_dsi0_sof = <0x10>;
		disp_gamma0_frame_done = <0x23>;
		disp_gamma0_sof = <0x0e>;
		disp_ovl0_frame_done = <0x1b>;
		disp_ovl0_frame_rst_done_pusle = <0x98>;
		disp_ovl0_sof = <0x07>;
		disp_pwm0_sof = <0x13>;
		disp_rdma0_frame_done = <0x1e>;
		disp_rdma0_sof = <0x09>;
		disp_rsz0_frame_done = <0x1d>;
		disp_rsz0_sof = <0x11>;
		disp_wdma0_frame_done = <0x1f>;
		disp_wdma0_rst_done = <0x93>;
		disp_wdma0_sof = <0x0a>;
		dsi0_done_event = <0x8f>;
		dsi0_irq_event = <0x8e>;
		dsi0_te_event = <0x8d>;
		dve_frame_done = <0x114>;
		g3d_config_base = <0x13000000 0x00 0xffff0000>;
		gce_base = <0x18020000 0x18 0xffff0000>;
		gcpu_base = <0x10050000 0x0f 0xffff0000>;
		img_dl_relay_sof = <0x12>;
		imgsys_base = <0x15020000 0x04 0xffff0000>;
		infra_na3_base = <0x10010000 0x0b 0xffff0000>;
		infra_na4_base = <0x10020000 0x0c 0xffff0000>;
		interrupts = <0x00 0x9a 0x08 0x00 0x9b 0x08>;
		jpgdec_done = <0x123>;
		jpgenc_done = <0x122>;
		kp_base = <0x18840000 0x09 0xffff0000>;
		linux,phandle = <0x79>;
		max_prefetch_cnt = <0x01>;
		mboxes = <0x30 0x00 0x00 0x04 0x30 0x01 0x00 0x04 0x30 0x02 0x00 0x05 0x30 0x03 0x00 0x04 0x30 0x04 0x00 0x04 0x30 0x05 0x00 0x04 0x30 0x06 0x00 0x03 0x30 0x07 0xffffffff 0x02 0x30 0x08 0x00 0x01 0x30 0x09 0x00 0x01 0x30 0x0a 0x00 0x01 0x30 0x0b 0x00 0x01 0x30 0x0c 0x00 0x01 0x30 0x0d 0x00 0x01 0x30 0x0e 0x00 0x01 0x30 0x0f 0x00 0x01>;
		mcucfg_base = <0x10040000 0x0e 0xffff0000>;
		mdp_ccorr0 = <0x2e>;
		mdp_ccorr0_frame_done = <0x15>;
		mdp_ccorr0_sof = <0x01>;
		mdp_color0 = <0x2d>;
		mdp_rdma0 = <0x27>;
		mdp_rdma0_frame_done = <0x14>;
		mdp_rdma0_rst_done = <0x97>;
		mdp_rdma0_sof = <0x00>;
		mdp_rsz0 = <0x28>;
		mdp_rsz0_frame_done = <0x16>;
		mdp_rsz0_sof = <0x02>;
		mdp_rsz1 = <0x29>;
		mdp_rsz1_frame_done = <0x17>;
		mdp_rsz1_sof = <0x03>;
		mdp_tdshp0 = <0x2c>;
		mdp_tdshp0_frame_done = <0x1a>;
		mdp_tdshp0_sof = <0x06>;
		mdp_wdma0 = <0x2a>;
		mdp_wdma_frame_done = <0x19>;
		mdp_wdma_rst_done = <0x94>;
		mdp_wdma_sof = <0x04>;
		mdp_wrot0 = <0x2b>;
		mdp_wrot0_rst_done = <0x95>;
		mdp_wrot0_sof = <0x05>;
		mdp_wrot0_write_frame_done = <0x18>;
		mediatek,mailbox-gce = <0x30>;
		mipitx0_base = <0x11c80000 0x63 0xffff0000>;
		mm_mutex = <0x2f>;
		mm_na_base = <0x14020000 0x03 0xffff0000>;
		mmsys_config = <0x26>;
		mmsys_config_base = <0x14000000 0x01 0xffff0000>;
		msdc2_base = <0x17020000 0x14 0xffff0000>;
		msdc3_base = <0x18000000 0x16 0xffff0000>;
		phandle = <0x79>;
		prefetch_size = <0x60>;
		pwm_sw_base = <0x1100e000 0x63 0xffff0000>;
		reg = <0x00 0x10238000 0x00 0x4000>;
		rsc_frame_done = <0x116>;
		scp_base = <0x10030000 0x0d 0xffff0000>;
		scp_sram_base = <0x10000000 0x0a 0xffff0000>;
		secure_thread = <0x08 0x0a>;
		sram_share_cnt = <0x01>;
		sram_share_engine = <0x0a>;
		sram_share_event = <0x2c6>;
		sram_size_cpr_64 = <0x40>;
		stream_done_0 = <0x82>;
		stream_done_1 = <0x83>;
		stream_done_2 = <0x84>;
		stream_done_3 = <0x85>;
		stream_done_4 = <0x86>;
		stream_done_5 = <0x87>;
		stream_done_6 = <0x88>;
		stream_done_7 = <0x89>;
		stream_done_8 = <0x8a>;
		stream_done_9 = <0x8b>;
		thread_count = <0x10>;
		topckgen_base = <0x18830000 0x08 0xffff0000>;
		usb0_base = <0x10200000 0x10 0xffff0000>;
		usb_sif_base = <0x10280000 0x11 0xffff0000>;
		vdec1_base = <0x17030000 0x15 0xffff0000>;
		vdec2_base = <0x18040000 0x19 0xffff0000>;
		vdec3_base = <0x18050000 0x1a 0xffff0000>;
		vdec_base = <0x17010000 0x13 0xffff0000>;
		vdec_gcon_base = <0x18800000 0x05 0xffff0000>;
		venc_128byte_cnt_done = <0x125>;
		venc_done = <0x121>;
		venc_gcon_base = <0x18810000 0x06 0xffff0000>;
		venc_mb_done = <0x124>;
		wmf_frame_done = <0x115>;
	};

	gce_mbox@10238000 {
		#gce-event-cells = <0x01>;
		#gce-subsys-cells = <0x02>;
		#mbox-cells = <0x03>;
		clock-names = "gce\0GCE_TIMER";
		clocks = <0x24 0x09 0x24 0x18>;
		compatible = "mediatek,mailbox-gce";
		interrupts = <0x00 0x9a 0x08 0x00 0x9b 0x08>;
		linux,phandle = <0x30>;
		phandle = <0x30>;
		reg = <0x00 0x10238000 0x00 0x4000>;
	};

	gce_mbox_svp@10238000 {
		#mbox-cells = <0x03>;
		clock-names = "gce\0GCE_TIMER";
		clocks = <0x24 0x09 0x24 0x18>;
		compatible = "mediatek,mailbox-gce-svp";
		interrupts = <0x00 0x9a 0x08 0x00 0x9b 0x08>;
		linux,phandle = <0x7a>;
		phandle = <0x7a>;
		reg = <0x00 0x10238000 0x00 0x4000>;
	};

	gic500@0c000000 {
		compatible = "mediatek,gic500";
		reg = <0x00 0xc000000 0x00 0x1000>;
	};

	gic_cpu@0c400000 {
		compatible = "mediatek,gic_cpu";
		reg = <0x00 0xc400000 0x00 0x40000>;
	};

	gpio {
		compatible = "mediatek,gpio_usage_mapping";
		linux,phandle = <0x50>;
		phandle = <0x50>;
	};

	gpio@10005000 {
		compatible = "mediatek,gpio";
		linux,phandle = <0x51>;
		phandle = <0x51>;
		reg = <0x00 0x10005000 0x00 0x1000>;
	};

	gps {
		compatible = "mediatek,gps";
	};

	gpufreq {
		clock-names = "clk_mux\0clk_main_parent\0clk_sub_parent\0mtcmos_mfg_async\0mtcmos_mfg\0mtcmos_mfg_core0";
		clocks = <0x1e 0x64 0x1e 0x26 0x1f 0x25 0x08 0x25 0x04 0x25 0x07>;
		compatible = "mediatek,mt6765-gpufreq";
	};

	hacc@1000a000 {
		compatible = "mediatek,hacc";
		interrupts = <0x00 0xbd 0x08>;
		reg = <0x00 0x1000a000 0x00 0x1000>;
	};

	i2c0@11007000 {
		aed = <0x1a>;
		clock-div = <0x05>;
		clock-names = "main\0dma";
		clocks = <0x24 0x0b 0x24 0x26>;
		compatible = "mediatek,i2c";
		eh_cfg = <0x20>;
		gpio_start = <0x10002a00>;
		id = <0x00>;
		interrupts = <0x00 0x54 0x08>;
		linux,phandle = <0x7f>;
		mediatek,hs_only;
		mem_len = <0x200>;
		phandle = <0x7f>;
		pu_cfg = <0x50>;
		reg = <0x00 0x11007000 0x00 0x1000 0x00 0x11000080 0x00 0x80>;
		rsel_cfg = <0x70>;
		scl-gpio-id = <0x53>;
		sda-gpio-id = <0x52>;
	};

	i2c1@11008000 {
		aed = <0x1a>;
		clock-div = <0x05>;
		clock-names = "main\0dma";
		clocks = <0x24 0x0b 0x24 0x26>;
		compatible = "mediatek,i2c";
		eh_cfg = <0x20>;
		gpio_start = <0x10002a00>;
		id = <0x01>;
		interrupts = <0x00 0x55 0x08>;
		linux,phandle = <0x80>;
		mediatek,hs_only;
		mem_len = <0x200>;
		phandle = <0x80>;
		pu_cfg = <0x50>;
		reg = <0x00 0x11008000 0x00 0x1000 0x00 0x11000100 0x00 0x80>;
		rsel_cfg = <0x70>;
		scl-gpio-id = <0x54>;
		sda-gpio-id = <0x51>;
	};

	i2c2@11009000 {
		aed = <0x1a>;
		ch_offset_ccu = <0x200>;
		ch_offset_default = <0x100>;
		clock-div = <0x05>;
		clock-names = "main\0dma";
		clocks = <0x24 0x0b 0x24 0x26>;
		compatible = "mediatek,i2c";
		eh_cfg = <0x20>;
		gpio_start = <0x10002800>;
		id = <0x02>;
		interrupts = <0x00 0x56 0x08>;
		linux,phandle = <0x81>;
		mediatek,hs_only;
		mem_len = <0x200>;
		phandle = <0x81>;
		pu_cfg = <0x60>;
		reg = <0x00 0x11009000 0x00 0x1000 0x00 0x11000180 0x00 0x180>;
		rsel_cfg = <0xa0>;
		scl-gpio-id = <0x67>;
		sda-gpio-id = <0x68>;
	};

	i2c3@1100f000 {
		aed = <0x1a>;
		ch_offset_default = <0x100>;
		clock-div = <0x05>;
		clock-names = "main\0dma";
		clocks = <0x24 0x0b 0x24 0x26>;
		compatible = "mediatek,i2c";
		eh_cfg = <0x20>;
		gpio_start = <0x10002600>;
		id = <0x03>;
		interrupts = <0x00 0x57 0x08>;
		linux,phandle = <0x82>;
		mediatek,hs_only;
		mem_len = <0x200>;
		phandle = <0x82>;
		pu_cfg = <0x90>;
		reg = <0x00 0x1100f000 0x00 0x1000 0x00 0x11000300 0x00 0x100>;
		rsel_cfg = <0xb0>;
		scl-gpio-id = <0x32>;
		sda-gpio-id = <0x33>;
	};

	i2c4@11011000 {
		aed = <0x1a>;
		ch_offset_ccu = <0x200>;
		ch_offset_default = <0x100>;
		clock-div = <0x05>;
		clock-names = "main\0dma";
		clocks = <0x24 0x0b 0x24 0x26>;
		compatible = "mediatek,i2c";
		eh_cfg = <0x20>;
		gpio_start = <0x10002800>;
		id = <0x04>;
		interrupts = <0x00 0x58 0x08>;
		linux,phandle = <0x83>;
		mediatek,hs_only;
		mem_len = <0x200>;
		phandle = <0x83>;
		pu_cfg = <0x60>;
		reg = <0x00 0x11011000 0x00 0x1000 0x00 0x11000400 0x00 0x180>;
		rsel_cfg = <0xa0>;
		scl-gpio-id = <0x69>;
		sda-gpio-id = <0x6a>;
	};

	i2c5@11016000 {
		aed = <0x1a>;
		clock-div = <0x05>;
		clock-names = "main\0dma";
		clocks = <0x24 0x0b 0x24 0x26>;
		compatible = "mediatek,i2c";
		eh_cfg = <0x20>;
		gpio_start = <0x10002600>;
		id = <0x05>;
		interrupts = <0x00 0x82 0x08>;
		linux,phandle = <0x84>;
		mediatek,hs_only;
		mem_len = <0x200>;
		phandle = <0x84>;
		pu_cfg = <0x90>;
		reg = <0x00 0x11016000 0x00 0x1000 0x00 0x11000580 0x00 0x80>;
		rsel_cfg = <0xb0>;
		scl-gpio-id = <0x30>;
		sda-gpio-id = <0x31>;
	};

	i2c6@1100d000 {
		aed = <0x1a>;
		ch_offset_ccu = <0x200>;
		ch_offset_default = <0x100>;
		clock-div = <0x05>;
		clock-names = "main\0dma";
		clocks = <0x24 0x0b 0x24 0x26>;
		compatible = "mediatek,i2c";
		eh_cfg = <0x20>;
		gpio_start = <0x10002c00>;
		id = <0x06>;
		interrupts = <0x00 0x83 0x08>;
		linux,phandle = <0x85>;
		mediatek,hs_only;
		mem_len = <0x200>;
		phandle = <0x85>;
		pu_cfg = <0x50>;
		reg = <0x00 0x1100d000 0x00 0x1000 0x00 0x11000600 0x00 0x80>;
		rsel_cfg = <0x70>;
		scl-gpio-id = <0xa1>;
		sda-gpio-id = <0xa2>;
	};

	i2c7 {
		linux,phandle = <0xa4>;
		phandle = <0xa4>;
	};

	i2c8 {
		linux,phandle = <0xa5>;
		phandle = <0xa5>;
	};

	i2c9 {
		linux,phandle = <0xa6>;
		phandle = <0xa6>;
	};

	i2c_common {
		check_max_freq = [01];
		cnt_constraint = [01];
		compatible = "mediatek,i2c_common";
		dma_support = [02];
		ext_time_config = [18 01];
		idvfs = [01];
		linux,phandle = <0x7e>;
		phandle = <0x7e>;
		set_dt_div = [01];
		set_ltiming = [01];
		ver = [02];
	};

	imgsys@15020000 {
		#clock-cells = <0x01>;
		clock-names = "ISP_SCP_SYS_DIS\0ISP_SCP_SYS_ISP\0ISP_SCP_SYS_CAM\0ISP_CLK_IMG_DIP\0ISP_CLK_CAM\0ISP_CLK_CAMTG\0ISP_CLK_CAM_SENINF\0ISP_CLK_CAMSV0\0ISP_CLK_CAMSV1\0ISP_CLK_CAMSV2";
		clocks = <0x25 0x03 0x25 0x05 0x25 0x09 0x42 0x01 0x43 0x02 0x43 0x03 0x43 0x04 0x43 0x05 0x43 0x06 0x43 0x07>;
		compatible = "mediatek,imgsys\0syscon";
		linux,phandle = <0x42>;
		phandle = <0x42>;
		reg = <0x00 0x15020000 0x00 0x1000>;
	};

	imp_iic@11017000 {
		compatible = "mediatek,imp_iic";
		reg = <0x00 0x11017000 0x00 0x1000>;
	};

	infra_mbist@1020d000 {
		compatible = "mediatek,infra_mbist";
		reg = <0x00 0x1020d000 0x00 0x1000>;
	};

	infracfg@1020e000 {
		compatible = "mediatek,infracfg";
		reg = <0x00 0x1020e000 0x00 0x1000>;
	};

	infracfg_ao@10001000 {
		#clock-cells = <0x01>;
		compatible = "mediatek,infracfg_ao\0syscon";
		interrupts = <0x00 0x93 0x01>;
		linux,phandle = <0x24>;
		phandle = <0x24>;
		reg = <0x00 0x10001000 0x00 0x1000>;
	};

	interrupt-controller@0c000000 {
		#address-cells = <0x02>;
		#interrupt-cells = <0x03>;
		#redistributor-regions = <0x01>;
		#size-cells = <0x02>;
		compatible = "arm,gic-v3";
		interrupt-controller;
		interrupt-parent = <0x11>;
		interrupts = <0x01 0x09 0x04>;
		linux,phandle = <0x11>;
		phandle = <0x11>;
		reg = <0x00 0xc000000 0x00 0x40000 0x00 0xc100000 0x00 0x200000 0x00 0x10200a80 0x00 0x50>;
	};

	intpol-controller@10200a80 {
		#interrupt-cells = <0x03>;
		compatible = "mediatek,mt6577-sysirq";
		interrupt-controller;
		interrupt-parent = <0x11>;
		linux,phandle = <0x01>;
		phandle = <0x01>;
		reg = <0x00 0x10200a80 0x00 0x50>;
	};

	io_cfg_bl@10002600 {
		compatible = "mediatek,io_cfg_bl";
		reg = <0x00 0x10002600 0x00 0x200>;
	};

	io_cfg_lb@10002400 {
		compatible = "mediatek,io_cfg_lb";
		reg = <0x00 0x10002400 0x00 0x200>;
	};

	io_cfg_lm@10002200 {
		compatible = "mediatek,io_cfg_lm";
		reg = <0x00 0x10002200 0x00 0x200>;
	};

	io_cfg_lt@10002000 {
		compatible = "mediatek,io_cfg_lt";
		reg = <0x00 0x10002000 0x00 0x200>;
	};

	io_cfg_rb@10002a00 {
		compatible = "mediatek,io_cfg_rb";
		reg = <0x00 0x10002a00 0x00 0x200>;
	};

	io_cfg_rr@10002800 {
		compatible = "mediatek,io_cfg_rr";
		reg = <0x00 0x10002800 0x00 0x200>;
	};

	io_cfg_rt@10002c00 {
		compatible = "mediatek,io_cfg_rt";
		reg = <0x00 0x10002c00 0x00 0x200>;
	};

	iocfg_0@10002000 {
		compatible = "mediatek,iocfg_0";
		reg = <0x00 0x10002000 0x00 0x200>;
	};

	iocfg_1@10002200 {
		compatible = "mediatek,iocfg_1";
		reg = <0x00 0x10002200 0x00 0x200>;
	};

	iocfg_2@10002400 {
		compatible = "mediatek,iocfg_2";
		reg = <0x00 0x10002400 0x00 0x200>;
	};

	iocfg_3@10002600 {
		compatible = "mediatek,iocfg_3";
		reg = <0x00 0x10002600 0x00 0x200>;
	};

	iocfg_4@10002800 {
		compatible = "mediatek,iocfg_4";
		reg = <0x00 0x10002800 0x00 0x200>;
	};

	iocfg_5@10002a00 {
		compatible = "mediatek,iocfg_5";
		reg = <0x00 0x10002a00 0x00 0x200>;
	};

	irq_nfc {
		compatible = "mediatek,irq_nfc-eint";
		linux,phandle = <0x95>;
		phandle = <0x95>;
	};

	irtx_pwm {
		compatible = "mediatek,irtx-pwm";
		linux,phandle = <0xa0>;
		phandle = <0xa0>;
		pwm_ch = <0x00>;
		pwm_data_invert = <0x00>;
	};

	kd_camera_hw1@1a040000 {
		cam3_enable_sensor = "gc2375hmain3_mipi_raw gc02m1_mipi_raw";
		clock-names = "CLK_TOP_CAMTG_SEL\0CLK_TOP_CAMTG1_SEL\0CLK_TOP_CAMTG2_SEL\0CLK_TOP_CAMTG3_SEL\0CLK_MCLK_6M\0CLK_MCLK_12M\0CLK_MCLK_13M\0CLK_MCLK_48M\0CLK_MCLK_52M\0CLK_MCLK_24M\0CLK_MCLK_26M\0CLK_CAM_SENINF_CG\0CLK_MIPI_C0_26M_CG\0CLK_MIPI_C1_26M_CG\0CLK_MIPI_ANA_0A_CG\0CLK_MIPI_ANA_0B_CG\0CLK_MIPI_ANA_1A_CG\0CLK_MIPI_ANA_1B_CG\0CLK_MIPI_ANA_2A_CG\0CLK_MIPI_ANA_2B_CG\0CLK_TOP_CAMTM_SEL_CG\0CLK_TOP_CAMTM_208_CG\0CLK_SCP_SYS_CAM";
		clocks = <0x1e 0x66 0x1e 0x67 0x1e 0x68 0x1e 0x69 0x1e 0x14 0x1e 0x13 0x1e 0x1d 0x1e 0x11 0x1e 0x1c 0x1e 0x12 0x1f 0x43 0x04 0x41 0x0e 0x41 0x12 0x45 0x00 0x46 0x00 0x47 0x00 0x48 0x00 0x49 0x00 0x4a 0x00 0x1e 0x7d 0x1e 0x1a 0x25 0x09>;
		compatible = "mediatek,camera_hw";
		linux,phandle = <0x98>;
		phandle = <0x98>;
		reg = <0x00 0x1a040000 0x00 0x1000>;
	};

	kp@10010000 {
		compatible = "mediatek,kp";
		interrupts = <0x00 0xb4 0x02>;
		linux,phandle = <0x1a>;
		phandle = <0x1a>;
		reg = <0x00 0x10010000 0x00 0x1000>;
	};

	l2c_parity {
		compatible = "mediatek,l2c_parity-v1";
		interrupts = <0x00 0x18 0x04 0x00 0x19 0x04>;
	};

	lk_charger {
		ac_charger_current = <0x1cafc0>;
		ac_charger_input_current = <0x1cafc0>;
		charging_host_charger_current = <0xf4240>;
		compatible = "mediatek,lk_charger";
		enable_anime;
		fast_charge_voltage = <0x2625a0>;
		linux,phandle = <0x9d>;
		max_charger_voltage = <0x632ea0>;
		non_std_ac_charger_current = <0x7ef40>;
		pd_charger_current = <0x7a120>;
		phandle = <0x9d>;
		ta_ac_charger_current = <0x2dc6c0>;
		temp_t1_threshold = <0x00>;
		temp_t3_threshold = <0x2d>;
		temp_t4_threshold = <0x32>;
		usb_charger_current = <0x7a120>;
	};

	m4u@10205000 {
		#iommu-cells = <0x01>;
		cell-index = <0x00>;
		compatible = "mediatek,iommu_v0";
		interrupts = <0x00 0x9e 0x08>;
		linux,phandle = <0x4b>;
		mediatek,larbs = <0x20 0x21 0x22 0x23>;
		phandle = <0x4b>;
		reg = <0x00 0x10205000 0x00 0x1000>;
	};

	mbist@17050000 {
		compatible = "mediatek,mbist";
		reg = <0x00 0x17050000 0x00 0x10000>;
	};

	mbist_ao@10013000 {
		compatible = "mediatek,mbist_ao";
		reg = <0x00 0x10013000 0x00 0x1000>;
	};

	mcdi@0010fc00 {
		compatible = "mediatek,mt6765-mcdi";
		reg = <0x00 0x10fc00 0x00 0x800>;
	};

	mcucfg@10200000 {
		compatible = "mediatek,mcucfg";
		interrupts = <0x00 0x00 0x08>;
		reg = <0x00 0x10200000 0x00 0x1000>;
	};

	mcucfg_mp0_counter@10200000 {
		compatible = "mediatek,mcucfg_mp0_counter";
		reg = <0x00 0x10200000 0x00 0x4000>;
	};

	mcupm_reg@10216000 {
		compatible = "mediatek,mcupm_reg";
		reg = <0x00 0x10216000 0x00 0x1000>;
	};

	mcupm_sram0@10217000 {
		compatible = "mediatek,mcupm_sram0";
		reg = <0x00 0x10217000 0x00 0x1000>;
	};

	mcupm_sram1@10218000 {
		compatible = "mediatek,mcupm_sram1";
		reg = <0x00 0x10218000 0x00 0x1000>;
	};

	mcupm_sram2@10211000 {
		compatible = "mediatek,mcupm_sram2";
		reg = <0x00 0x10211000 0x00 0x1000>;
	};

	mcupm_sram3@10213000 {
		compatible = "mediatek,mcupm_sram3";
		reg = <0x00 0x10213000 0x00 0x1000>;
	};

	md1_sim1_hot_plug_eint {
		linux,phandle = <0xa8>;
		phandle = <0xa8>;
	};

	md1_sim2_hot_plug_eint {
		linux,phandle = <0xa9>;
		phandle = <0xa9>;
	};

	md_ccif0@1020a000 {
		compatible = "mediatek,md_ccif0";
		reg = <0x00 0x1020a000 0x00 0x1000>;
	};

	md_ccif1@1020c000 {
		compatible = "mediatek,md_ccif1";
		reg = <0x00 0x1020c000 0x00 0x1000>;
	};

	md_ccif2@1023d000 {
		compatible = "mediatek,md_ccif2";
		reg = <0x00 0x1023d000 0x00 0x1000>;
	};

	md_ccif3@1023f000 {
		compatible = "mediatek,md_ccif3";
		reg = <0x00 0x1023f000 0x00 0x1000>;
	};

	mdcldma@10014000 {
		clock-names = "scp-sys-md1-main\0infra-cldma-bclk\0infra-ccif-ap\0infra-ccif-md\0infra-ccif1-ap\0infra-ccif1-md\0infra-ccif2-ap\0infra-ccif2-md";
		clocks = <0x25 0x00 0x24 0x32 0x24 0x29 0x24 0x2c 0x24 0x23 0x24 0x24 0x24 0x51 0x24 0x52>;
		compatible = "mediatek,mdcldma";
		interrupts = <0x00 0xa5 0x04 0x00 0x94 0x08 0x00 0x95 0x08 0x00 0x105 0x02>;
		linux,phandle = <0x1c>;
		mediatek,cldma_capability = <0x06>;
		mediatek,md_id = <0x00>;
		phandle = <0x1c>;
		reg = <0x00 0x10014000 0x00 0x1000 0x00 0x1021b000 0x00 0x1000 0x00 0x10209000 0x00 0x1000 0x00 0x1020a000 0x00 0x1000>;
	};

	mdcldmain@1021c000 {
		compatible = "mediatek,mdcldmain";
		reg = <0x00 0x1021c000 0x00 0x400>;
	};

	mdcldmain_ao@10015000 {
		compatible = "mediatek,mdcldmain_ao";
		reg = <0x00 0x10015000 0x00 0x400>;
	};

	mdcldmamisc@1021c800 {
		compatible = "mediatek,mdcldmamisc";
		reg = <0x00 0x1021c800 0x00 0x1000>;
	};

	mdcldmamisc_ao@10015800 {
		compatible = "mediatek,mdcldmamisc_ao";
		reg = <0x00 0x10015800 0x00 0x400>;
	};

	mdcldmaout@1021c400 {
		compatible = "mediatek,mdcldmaout";
		reg = <0x00 0x1021c400 0x00 0x400>;
	};

	mdcldmaout_ao@10015400 {
		compatible = "mediatek,mdcldmaout_ao";
		reg = <0x00 0x10015400 0x00 0x400>;
	};

	mdp_ccorr0@14005000 {
		clock-names = "MDP_CCORR";
		clocks = <0x26 0x01>;
		compatible = "mediatek,mdp_ccorr0";
		interrupts = <0x00 0xe2 0x08>;
		linux,phandle = <0x2e>;
		phandle = <0x2e>;
		reg = <0x00 0x14005000 0x00 0x1000>;
	};

	mdp_rdma0@14004000 {
		clock-names = "MDP_RDMA0";
		clocks = <0x26 0x00>;
		compatible = "mediatek,mdp_rdma0";
		interrupts = <0x00 0xd3 0x08>;
		linux,phandle = <0x27>;
		phandle = <0x27>;
		reg = <0x00 0x14004000 0x00 0x1000>;
	};

	mdp_rsz0@14006000 {
		clock-names = "MDP_RSZ0";
		clocks = <0x26 0x02>;
		compatible = "mediatek,mdp_rsz0";
		interrupts = <0x00 0xd4 0x08>;
		linux,phandle = <0x28>;
		phandle = <0x28>;
		reg = <0x00 0x14006000 0x00 0x1000>;
	};

	mdp_rsz1@14007000 {
		clock-names = "MDP_RSZ1";
		clocks = <0x26 0x03>;
		compatible = "mediatek,mdp_rsz1";
		interrupts = <0x00 0xd5 0x08>;
		linux,phandle = <0x29>;
		phandle = <0x29>;
		reg = <0x00 0x14007000 0x00 0x1000>;
	};

	mdp_tdshp0@1400a000 {
		clock-names = "MDP_TDSHP";
		clocks = <0x26 0x04>;
		compatible = "mediatek,mdp_tdshp0";
		linux,phandle = <0x2c>;
		phandle = <0x2c>;
		reg = <0x00 0x1400a000 0x00 0x1000>;
	};

	mdp_wdma0@14008000 {
		clock-names = "MDP_WDMA";
		clocks = <0x26 0x06>;
		compatible = "mediatek,mdp_wdma0";
		interrupts = <0x00 0xd8 0x08>;
		linux,phandle = <0x2a>;
		phandle = <0x2a>;
		reg = <0x00 0x14008000 0x00 0x1000>;
	};

	mdp_wrot0@14009000 {
		clock-names = "MDP_WROT0";
		clocks = <0x26 0x05>;
		compatible = "mediatek,mdp_wrot0";
		interrupts = <0x00 0xd7 0x08>;
		linux,phandle = <0x2b>;
		phandle = <0x2b>;
		reg = <0x00 0x14009000 0x00 0x1000>;
	};

	memory {
		device_type = "memory";
		reg = <0x00 0x40000000 0x00 0x20000000>;
	};

	memory-ssmr-features {
		2d_fr-size = <0x00 0x8000000>;
		compatible = "mediatek,memory-ssmr-features";
		iris-recognition-size = <0x00 0x10000000>;
		linux,phandle = <0xa2>;
		phandle = <0xa2>;
		prot-sharedmem-size = <0x00 0x8000000>;
		sdsp-firmware-size = <0x00 0x1000000>;
		sdsp-tee-sharedmem-size = <0x00 0x1000000>;
		svp-size = <0x00 0x10000000>;
		ta-elf-size = <0x00 0x1000000>;
		ta-stack-heap-size = <0x00 0x6000000>;
		tui-size = <0x00 0x4000000>;
		wfd-size = <0x00 0x4000000>;
	};

	mfg_cfg@13ffe000 {
		#clock-cells = <0x01>;
		compatible = "mediatek,mfgcfg\0syscon";
		linux,phandle = <0x93>;
		phandle = <0x93>;
		reg = <0x00 0x13ffe000 0x00 0x1000>;
	};

	mfg_doma@13000000 {
		clock-frequency = <0x21f98280>;
		compatible = "mediatek,doma";
		interrupt-names = "RGX";
		interrupts = <0x00 0x103 0x08>;
		reg = <0x00 0x13000000 0x00 0x80000>;
	};

	mipi_rx_ana_csi0a@11c10000 {
		#clock-cells = <0x01>;
		compatible = "mediatek,mipi_rx_ana_csi0a\0syscon";
		linux,phandle = <0x45>;
		phandle = <0x45>;
		reg = <0x00 0x11c10000 0x00 0x1000>;
	};

	mipi_rx_ana_csi0b@11c11000 {
		#clock-cells = <0x01>;
		compatible = "mediatek,mipi_rx_ana_csi0b\0syscon";
		linux,phandle = <0x46>;
		phandle = <0x46>;
		reg = <0x00 0x11c11000 0x00 0x1000>;
	};

	mipi_rx_ana_csi1a@11c12000 {
		#clock-cells = <0x01>;
		compatible = "mediatek,mipi_rx_ana_csi1a\0syscon";
		linux,phandle = <0x47>;
		phandle = <0x47>;
		reg = <0x00 0x11c12000 0x00 0x1000>;
	};

	mipi_rx_ana_csi1b@11c13000 {
		#clock-cells = <0x01>;
		compatible = "mediatek,mipi_rx_ana_csi1b\0syscon";
		linux,phandle = <0x48>;
		phandle = <0x48>;
		reg = <0x00 0x11c13000 0x00 0x1000>;
	};

	mipi_rx_ana_csi2a@11c14000 {
		#clock-cells = <0x01>;
		compatible = "mediatek,mipi_rx_ana_csi2a\0syscon";
		linux,phandle = <0x49>;
		phandle = <0x49>;
		reg = <0x00 0x11c14000 0x00 0x1000>;
	};

	mipi_rx_ana_csi2b@11c15000 {
		#clock-cells = <0x01>;
		compatible = "mediatek,mipi_rx_ana_csi2b\0syscon";
		linux,phandle = <0x4a>;
		phandle = <0x4a>;
		reg = <0x00 0x11c15000 0x00 0x1000>;
	};

	mipi_tx0@11c80000 {
		compatible = "mediatek,mipi_tx0";
		reg = <0x00 0x11c80000 0x00 0x10000>;
	};

	mmdvfs_pmqos {
		cam_freq = "mm_step0\0mm_step1\0mm_step2";
		clock-names = "mmdvfs_clk_mm_sel_ck\0mmdvfs_clk_mmpll_ck\0mmdvfs_clk_univpll1_d2_ck\0mmdvfs_clk_mmpll_d2_ck";
		clocks = <0x1e 0x62 0x1e 0x21 0x1e 0x17 0x1e 0x22>;
		compatible = "mediatek,mmdvfs_pmqos";
		disp_freq = "mm_step0\0mm_step1\0mm_step2";
		img_freq = "mm_step0\0mm_step1\0mm_step2";
		mdp_freq = "mm_step0\0mm_step1\0mm_step2";
		mm_step0 = <0x1c9 0x01 0x00 0x01>;
		mm_step1 = <0x138 0x01 0x00 0x02>;
		mm_step2 = <0xe4 0x01 0x00 0x03>;
		vdec_freq = "mm_step0\0mm_step1\0mm_step2";
		venc_freq = "mm_step0\0mm_step1\0mm_step2";
		vopp_steps = <0x00 0x01 0x03>;
	};

	mmsys_config@14000000 {
		#clock-cells = <0x01>;
		clock-names = "CAM_MDP\0IMG_DL_RELAY\0IMG_DL_ASYNC_TOP";
		clocks = <0x26 0x17 0x26 0x1a 0x26 0x1b>;
		compatible = "mediatek,mmsys_config\0syscon";
		interrupts = <0x00 0xe3 0x08>;
		linux,phandle = <0x26>;
		phandle = <0x26>;
		reg = <0x00 0x14000000 0x00 0x1000>;
	};

	mobicore {
		compatible = "trustonic,mobicore";
		interrupts = <0x00 0x10f 0x01>;
	};

	modem_temp_share@10018000 {
		compatible = "mediatek,modem_temp_share";
		reg = <0x00 0x10018000 0x00 0x1000>;
	};

	mrdump_ext_rst {
		compatible = "mediatek, mrdump_ext_rst-eint";
		force_mode = "EINT";
		linux,phandle = <0x74>;
		mode = "IRQ";
		phandle = <0x74>;
		status = "okay";
	};

	msdc0_pad_macro@11cd0000 {
		compatible = "mediatek,msdc0_pad_macro";
		reg = <0x00 0x11cd0000 0x00 0x10000>;
	};

	msdc0_top@11cd0000 {
		compatible = "mediatek,msdc0_top";
		reg = <0x00 0x11cd0000 0x00 0x1000>;
	};

	msdc1_ins@0 {
		compatible = "mediatek,mt6765-sdcard-ins";
		linux,phandle = <0x91>;
		phandle = <0x91>;
	};

	msdc1_pad_macro@11c90000 {
		compatible = "mediatek,msdc1_pad_macro";
		reg = <0x00 0x11c90000 0x00 0x10000>;
	};

	msdc1_top@11c90000 {
		compatible = "mediatek,msdc1_top";
		reg = <0x00 0x11c90000 0x00 0x1000>;
	};

	msdc@11230000 {
		bootable;
		bus-width = <0x08>;
		cap-mmc-highspeed;
		clk_src = [01];
		clock-names = "msdc0-clock\0msdc0-hclock\0msdc0-aes-clock";
		clocks = <0x24 0x4c 0x24 0x1c 0x24 0x44>;
		compatible = "mediatek,msdc";
		host_function = [00];
		index = [00];
		interrupts = <0x00 0x4f 0x08>;
		linux,phandle = <0x8d>;
		max-frequency = <0xbebc200>;
		mmc-ddr-1_8v;
		mmc-hs200-1_8v;
		mmc-hs400-1_8v;
		no-sd;
		no-sdio;
		non-removable;
		phandle = <0x8d>;
		pinctl = <0x32>;
		pinctl_hs200 = <0x34>;
		pinctl_hs400 = <0x33>;
		reg = <0x00 0x11230000 0x00 0x10000>;
		register_setting = <0x35>;
		status = "okay";
		vmmc-supply = <0x36>;
	};

	msdc@11240000 {
		bus-width = <0x04>;
		cap-sd-highspeed;
		cd-gpios = <0x3c 0x00 0x00>;
		cd_level = [01];
		clk_src = [02];
		clock-names = "msdc1-clock\0msdc1-hclock";
		clocks = <0x24 0x4d 0x24 0x1d>;
		compatible = "mediatek,msdc";
		host_function = [01];
		index = [01];
		interrupts = <0x00 0x50 0x08>;
		linux,phandle = <0x8e>;
		max-frequency = <0xbebc200>;
		no-mmc;
		no-sdio;
		phandle = <0x8e>;
		pinctl = <0x37>;
		pinctl_ddr50 = <0x3a>;
		pinctl_sdr104 = <0x38>;
		pinctl_sdr50 = <0x39>;
		reg = <0x00 0x11240000 0x00 0x10000>;
		register_setting = <0x3b>;
		sd-uhs-ddr50;
		sd-uhs-sdr104;
		sd-uhs-sdr12;
		sd-uhs-sdr25;
		sd-uhs-sdr50;
		status = "okay";
		vmmc-supply = <0x3d>;
		vqmmc-supply = <0x3e>;
	};

	msdc@11250000 {
		compatible = "mediatek,msdc2";
		linux,phandle = <0x8f>;
		phandle = <0x8f>;
		reg = <0x00 0x11250000 0x00 0x10000>;
		status = "disable";
	};

	msdc@11260000 {
		compatible = "mediatek,msdc3";
		linux,phandle = <0x90>;
		phandle = <0x90>;
		reg = <0x00 0x11250000 0x00 0x10000>;
		status = "disable";
	};

	mt-pmic {
		compatible = "mediatek,mt_pmic";
		interrupt-controller;
		linux,phandle = <0x54>;
		phandle = <0x54>;

		buck_regulators {

			buck_vcore {
				linux,phandle = <0x58>;
				phandle = <0x58>;
				regulator-enable-ramp-delay = <0xdc>;
				regulator-max-microvolt = <0x1406f4>;
				regulator-min-microvolt = <0x7ea5e>;
				regulator-name = "vcore";
				regulator-ramp-delay = <0x186a>;
			};

			buck_vmodem {
				linux,phandle = <0x57>;
				phandle = <0x57>;
				regulator-enable-ramp-delay = <0xdc>;
				regulator-max-microvolt = <0x123716>;
				regulator-min-microvolt = <0x7a120>;
				regulator-name = "vmodem";
				regulator-ramp-delay = <0x186a>;
			};

			buck_vpa {
				linux,phandle = <0x5a>;
				phandle = <0x5a>;
				regulator-enable-ramp-delay = <0xdc>;
				regulator-max-microvolt = <0x37b1d0>;
				regulator-min-microvolt = <0x7a120>;
				regulator-name = "vpa";
				regulator-ramp-delay = <0xc350>;
			};

			buck_vproc {
				linux,phandle = <0x59>;
				phandle = <0x59>;
				regulator-enable-ramp-delay = <0xdc>;
				regulator-max-microvolt = <0x1406f4>;
				regulator-min-microvolt = <0x7ea5e>;
				regulator-name = "vproc";
				regulator-ramp-delay = <0x186a>;
			};

			buck_vs1 {
				linux,phandle = <0x56>;
				phandle = <0x56>;
				regulator-enable-ramp-delay = <0xdc>;
				regulator-max-microvolt = <0x2191c0>;
				regulator-min-microvolt = <0x124f80>;
				regulator-name = "vs1";
				regulator-ramp-delay = <0x30d4>;
			};
		};

		ldo_regulators {

			ldo_vaud28 {
				compatible = "regulator-fixed";
				linux,phandle = <0x6b>;
				phandle = <0x6b>;
				regulator-enable-ramp-delay = <0x108>;
				regulator-max-microvolt = <0x2ab980>;
				regulator-min-microvolt = <0x2ab980>;
				regulator-name = "vaud28";
			};

			ldo_vaux18 {
				compatible = "regulator-fixed";
				linux,phandle = <0x6a>;
				phandle = <0x6a>;
				regulator-enable-ramp-delay = <0x108>;
				regulator-max-microvolt = <0x1b7740>;
				regulator-min-microvolt = <0x1b7740>;
				regulator-name = "vaux18";
			};

			ldo_vcama {
				linux,phandle = <0x64>;
				phandle = <0x64>;
				regulator-enable-ramp-delay = <0x108>;
				regulator-max-microvolt = <0x2ab980>;
				regulator-min-microvolt = <0x2625a0>;
				regulator-name = "vcama";
			};

			ldo_vcamd {
				linux,phandle = <0x65>;
				phandle = <0x65>;
				regulator-enable-ramp-delay = <0x108>;
				regulator-max-microvolt = <0x1b7740>;
				regulator-min-microvolt = <0xf4240>;
				regulator-name = "vcamd";
			};

			ldo_vcamio {
				compatible = "regulator-fixed";
				linux,phandle = <0x66>;
				phandle = <0x66>;
				regulator-enable-ramp-delay = <0x108>;
				regulator-max-microvolt = <0x1b7740>;
				regulator-min-microvolt = <0x1b7740>;
				regulator-name = "vcamio";
			};

			ldo_vcn18 {
				compatible = "regulator-fixed";
				linux,phandle = <0x63>;
				phandle = <0x63>;
				regulator-enable-ramp-delay = <0x108>;
				regulator-max-microvolt = <0x1b7740>;
				regulator-min-microvolt = <0x1b7740>;
				regulator-name = "vcn18";
			};

			ldo_vcn28 {
				compatible = "regulator-fixed";
				linux,phandle = <0x62>;
				phandle = <0x62>;
				regulator-enable-ramp-delay = <0x108>;
				regulator-max-microvolt = <0x2ab980>;
				regulator-min-microvolt = <0x2ab980>;
				regulator-name = "vcn28";
			};

			ldo_vcn33_bt {
				linux,phandle = <0x60>;
				phandle = <0x60>;
				regulator-enable-ramp-delay = <0x108>;
				regulator-max-microvolt = <0x3567e0>;
				regulator-min-microvolt = <0x325aa0>;
				regulator-name = "vcn33_bt";
			};

			ldo_vcn33_wifi {
				linux,phandle = <0x61>;
				phandle = <0x61>;
				regulator-enable-ramp-delay = <0x108>;
				regulator-max-microvolt = <0x3567e0>;
				regulator-min-microvolt = <0x325aa0>;
				regulator-name = "vcn33_wifi";
			};

			ldo_vdram {
				linux,phandle = <0x6e>;
				phandle = <0x6e>;
				regulator-enable-ramp-delay = <0xce4>;
				regulator-max-microvolt = <0x124f80>;
				regulator-min-microvolt = <0x10c8e0>;
				regulator-name = "vdram";
			};

			ldo_vefuse {
				linux,phandle = <0x5f>;
				phandle = <0x5f>;
				regulator-enable-ramp-delay = <0x108>;
				regulator-max-microvolt = <0x325aa0>;
				regulator-min-microvolt = <0x124f80>;
				regulator-name = "vefuse";
			};

			ldo_vemc {
				linux,phandle = <0x36>;
				phandle = <0x36>;
				regulator-enable-ramp-delay = <0x2c>;
				regulator-max-microvolt = <0x325aa0>;
				regulator-min-microvolt = <0x2c4020>;
				regulator-name = "vemc";
			};

			ldo_vfe28 {
				compatible = "regulator-fixed";
				linux,phandle = <0x5b>;
				phandle = <0x5b>;
				regulator-enable-ramp-delay = <0x108>;
				regulator-max-microvolt = <0x2ab980>;
				regulator-min-microvolt = <0x2ab980>;
				regulator-name = "vfe28";
			};

			ldo_vibr {
				linux,phandle = <0x71>;
				phandle = <0x71>;
				regulator-enable-ramp-delay = <0x2c>;
				regulator-max-microvolt = <0x325aa0>;
				regulator-min-microvolt = <0x124f80>;
				regulator-name = "vibr";
			};

			ldo_vio18 {
				compatible = "regulator-fixed";
				linux,phandle = <0x6d>;
				phandle = <0x6d>;
				regulator-enable-ramp-delay = <0x108>;
				regulator-max-microvolt = <0x1b7740>;
				regulator-min-microvolt = <0x1b7740>;
				regulator-name = "vio18";
			};

			ldo_vio28 {
				compatible = "regulator-fixed";
				linux,phandle = <0x6c>;
				phandle = <0x6c>;
				regulator-enable-ramp-delay = <0x108>;
				regulator-max-microvolt = <0x2ab980>;
				regulator-min-microvolt = <0x2ab980>;
				regulator-name = "vio28";
			};

			ldo_vldo28 {
				linux,phandle = <0x67>;
				phandle = <0x67>;
				regulator-enable-ramp-delay = <0x108>;
				regulator-max-microvolt = <0x2dc6c0>;
				regulator-min-microvolt = <0x2ab980>;
				regulator-name = "vldo28";
			};

			ldo_vmc {
				linux,phandle = <0x3e>;
				phandle = <0x3e>;
				regulator-enable-ramp-delay = <0x2c>;
				regulator-max-microvolt = <0x325aa0>;
				regulator-min-microvolt = <0x1b7740>;
				regulator-name = "vmc";
			};

			ldo_vmch {
				linux,phandle = <0x3d>;
				phandle = <0x3d>;
				regulator-enable-ramp-delay = <0x2c>;
				regulator-max-microvolt = <0x325aa0>;
				regulator-min-microvolt = <0x2c4020>;
				regulator-name = "vmch";
			};

			ldo_vrf12 {
				compatible = "regulator-fixed";
				linux,phandle = <0x5e>;
				phandle = <0x5e>;
				regulator-enable-ramp-delay = <0x6e>;
				regulator-max-microvolt = <0x124f80>;
				regulator-min-microvolt = <0x124f80>;
				regulator-name = "vrf12";
			};

			ldo_vrf18 {
				compatible = "regulator-fixed";
				linux,phandle = <0x5d>;
				phandle = <0x5d>;
				regulator-enable-ramp-delay = <0x6e>;
				regulator-max-microvolt = <0x1b7740>;
				regulator-min-microvolt = <0x1b7740>;
				regulator-name = "vrf18";
			};

			ldo_vsim1 {
				linux,phandle = <0x6f>;
				phandle = <0x6f>;
				regulator-enable-ramp-delay = <0x108>;
				regulator-max-microvolt = <0x2f4d60>;
				regulator-min-microvolt = <0x19f0a0>;
				regulator-name = "vsim1";
			};

			ldo_vsim2 {
				linux,phandle = <0x70>;
				phandle = <0x70>;
				regulator-enable-ramp-delay = <0x108>;
				regulator-max-microvolt = <0x2f4d60>;
				regulator-min-microvolt = <0x19f0a0>;
				regulator-name = "vsim2";
			};

			ldo_vsram_others {
				linux,phandle = <0x68>;
				phandle = <0x68>;
				regulator-enable-ramp-delay = <0x6e>;
				regulator-max-microvolt = <0x1406f4>;
				regulator-min-microvolt = <0x7ea5e>;
				regulator-name = "vsram_others";
				regulator-ramp-delay = <0x186a>;
			};

			ldo_vsram_proc {
				linux,phandle = <0x69>;
				phandle = <0x69>;
				regulator-enable-ramp-delay = <0x6e>;
				regulator-max-microvolt = <0x1406f4>;
				regulator-min-microvolt = <0x7ea5e>;
				regulator-name = "vsram_proc";
				regulator-ramp-delay = <0x186a>;
			};

			ldo_vusb33 {
				linux,phandle = <0x72>;
				phandle = <0x72>;
				regulator-enable-ramp-delay = <0x108>;
				regulator-max-microvolt = <0x2f4d60>;
				regulator-min-microvolt = <0x2dc6c0>;
				regulator-name = "vusb33";
			};

			ldo_vxo22 {
				linux,phandle = <0x5c>;
				phandle = <0x5c>;
				regulator-enable-ramp-delay = <0x6e>;
				regulator-max-microvolt = <0x249f00>;
				regulator-min-microvolt = <0x2191c0>;
				regulator-name = "vxo22";
			};
		};

		mt635x-auxadc {
			#io-channel-cells = <0x01>;
			compatible = "mediatek,mt635x-auxadc";
			linux,phandle = <0x55>;
			phandle = <0x55>;

			accdet {
				channel = <0x09>;
			};

			bat_temp {
				channel = <0x03>;
				resistance-ratio = <0x01 0x01>;
			};

			batadc {
				avg-num = <0x80>;
				channel = <0x00>;
				resistance-ratio = <0x03 0x01>;
			};

			chip_temp {
				channel = <0x05>;
			};

			dcxo_temp {
				avg-num = <0x10>;
				channel = <0x0d>;
			};

			hpofs_cal {
				avg-num = <0x100>;
				channel = <0x0c>;
			};

			isense {
				avg-num = <0x80>;
				channel = <0x01>;
				resistance-ratio = <0x03 0x01>;
			};

			tsx_temp {
				avg-num = <0x80>;
				channel = <0x0b>;
			};

			vbif {
				channel = <0x0e>;
				resistance-ratio = <0x01 0x01>;
			};

			vcdt {
				channel = <0x02>;
			};

			vcore_temp {
				channel = <0x06>;
			};

			vproc_temp {
				channel = <0x07>;
			};
		};
	};

	mt6357_charger {
		compatible = "mediatek,mt6357_charger";
	};

	mt6357_gauge {
		alias_name = "mt6357";
		compatible = "mediatek,mt6357_gauge";
		gauge_name = "gauge";
	};

	mt6370_pmu_dts {
		#interrupt-cells = <0x01>;
		interrupt-controller;
		linux,phandle = <0xac>;
		mt6370,intr_gpio = <0x3c 0x03 0x00>;
		mt6370,intr_gpio_num = <0x03>;
		phandle = <0xac>;

		bled {
			compatible = "mediatek,mt6370_pmu_bled";
			interrupt-names = "bled_ocp";
			mt,bl_ocp_level = <0x02>;
			mt,bl_ovp_level = <0x03>;
			mt,bled_flash_ramp = <0x01>;
			mt,bled_name = "mt6370_pmu_bled";
			mt,bled_ramptime = <0x03>;
			mt,chan_en = <0x0f>;
			mt,map_linear;
			mt,max_bled_brightness = <0x200>;
			mt,pwm_avg_cycle = <0x00>;
			mt,pwm_deglitch = <0x01>;
			mt,pwm_fsample = <0x02>;
			mt,pwm_hys = <0x00>;
			mt,pwm_hys_en = <0x01>;
			mt,use_pwm;
		};

		charger {
			aicr = <0x7a120>;
			charger_name = "primary_chg";
			compatible = "mediatek,mt6370_pmu_charger";
			cv = <0x426030>;
			dc_wdt = "\0=\t";
			enable_te;
			enable_wdt;
			ichg = <0x1e8480>;
			ieoc = <0x249f0>;
			interrupt-names = "chg_mivr\0chg_aiclmeasi\0attachi\0ovpctrl_uvp_d_evt\0chg_wdtmri\0chg_vbusov\0chg_tmri\0chg_treg";
			ircmp_resistor = <0x61a8>;
			ircmp_vclamp = <0x7d00>;
			load_switch_name = "primary_load_switch";
			mivr = <0x432380>;
			safety_timer = <0x0c>;
		};

		core {
			compatible = "mediatek,mt6370_pmu_core";
			i2cstmr_rst_tmr = <0x00>;
			int_deg = <0x00>;
			int_wdt = <0x00>;
			interrupt-names = "otp\0vdda_ovp\0vdda_uv";
			mrstb_en;
			mrstb_tmr = <0x03>;
		};

		dsv {
			compatible = "mediatek,mt6370_pmu_dsv";
			db_delay = <0x03>;
			db_ext_en = <0x00>;
			db_freq_pm = <0x00>;
			db_periodic_fix = <0x00>;
			db_periodic_mode = <0x00>;
			db_single_pin = <0x00>;
			db_startup = <0x00>;
			db_vbst = <0x1644>;
			db_vneg_20ms = <0x01>;
			db_vneg_disc = <0x00>;
			db_vneg_slew = <0x01>;
			db_vpos_20ms = <0x01>;
			db_vpos_disc = <0x01>;
			db_vpos_slew = <0x01>;
			interrupt-names = "dsv_vneg_ocp\0dsv_vpos_ocp\0dsv_bst_ocp\0dsv_vneg_scp\0dsv_vpos_scp";

			mt6370_dsvn {
				regulator-max-microvolt = <0x5b8d80>;
				regulator-min-microvolt = "\0=\t";
				regulator-name = "dsv_neg";
			};

			mt6370_dsvp {
				regulator-max-microvolt = <0x5b8d80>;
				regulator-min-microvolt = "\0=\t";
				regulator-name = "dsv_pos";
			};
		};

		ldo {
			compatible = "mediatek,mt6370_pmu_ldo";
			interrupt-names = "ldo_oc";
			ldo_oms = <0x01>;
			ldo_vrc_lt = <0x01>;

			mt6370_ldo {
				regulator-max-microvolt = "\0=\t";
				regulator-min-microvolt = <0x186a00>;
				regulator-name = "irtx_ldo";
			};
		};

		mt6370_pmu_fled1 {
			compatible = "mediatek,mt6370_pmu_fled1";
			fled_enable = <0x01>;
			interrupt-names = "fled_lvf\0fled2_short\0fled1_short";
			strobe_cur = <0x124f80>;
			strobe_timeout = <0x960>;
			torch_cur = <0x493e0>;
		};

		mt6370_pmu_fled2 {
			compatible = "mediatek,mt6370_pmu_fled2";
			fled_enable = <0x01>;
			strobe_cur = <0xf4240>;
			strobe_timeout = <0x4b0>;
			torch_cur = <0x30d40>;
		};

		rgbled {
			compatible = "mediatek,mt6370_pmu_rgbled";
			interrupt-names = "isink4_short\0isink3_short\0isink2_short\0isink1_short\0isink4_open\0isink3_open\0isink2_open\0isink1_open";
			mt,led_default_trigger = "cc_mode\0cc_mode\0cc_mode\0none";
			mt,led_name = "mt6370_pmu_led1\0mt6370_pmu_led2\0mt6370_pmu_led3\0mt6370_pmu_led4";
		};
	};

	mt_charger {
		compatible = "mediatek,mt-charger";
		linux,phandle = <0x9c>;
		phandle = <0x9c>;
	};

	mt_soc_anc_pcm {
		compatible = "mediatek,mt_soc_pcm_anc";
	};

	mt_soc_codec_dummy_name {
		compatible = "mediatek,mt_soc_codec_dummy";
	};

	mt_soc_codec_name {
		compatible = "mediatek,mt_soc_codec_63xx";
		use_hp_depop_flow = <0x00>;
		use_ul_260k = <0x00>;
	};

	mt_soc_dai_name {
		compatible = "mediatek,mt_soc_dai_stub";
	};

	mt_soc_deep_buffer_dl_pcm {
		compatible = "mediatek,mt_soc_pcm_deep_buffer_dl";
	};

	mt_soc_dl1_awb_pcm {
		compatible = "mediatek,mt_soc_pcm_dl1_awb";
	};

	mt_soc_dl1_pcm@11220000 {
		clock-names = "aud_afe_clk\0aud_dac_clk\0aud_dac_predis_clk\0aud_adc_clk\0aud_apll22m_clk\0aud_apll1_tuner_clk\0aud_tml_clk\0aud_infra_clk\0mtkaif_26m_clk\0top_mux_audio\0top_mux_audio_int\0top_sys_pll1_d4\0top_mux_aud_1\0top_apll1_ck\0top_mux_aud_eng1\0top_apll1_d8\0apmixed_apll1\0top_clk26m_clk";
		clocks = <0x40 0x00 0x40 0x04 0x40 0x05 0x40 0x03 0x40 0x01 0x40 0x02 0x40 0x06 0x24 0x2b 0x24 0x33 0x1e 0x6f 0x1e 0x70 0x1e 0x03 0x1e 0x71 0x1e 0x29 0x1e 0x72 0x1e 0x2c 0x41 0x08 0x1f>;
		compatible = "mediatek,mt_soc_pcm_dl1";
		interrupts = <0x00 0x99 0x08>;
		linux,phandle = <0x92>;
		phandle = <0x92>;
		reg = <0x00 0x11220000 0x00 0x1000>;
	};

	mt_soc_dl2_pcm {
		compatible = "mediatek,mt_soc_pcm_dl2";
	};

	mt_soc_dummy_pcm {
		compatible = "mediatek,mt_soc_pcm_dummy";
	};

	mt_soc_fm_i2s_awb_pcm {
		compatible = "mediatek,mt_soc_pcm_fm_i2s_awb";
	};

	mt_soc_fm_i2s_pcm {
		compatible = "mediatek,mt_soc_pcm_fm_i2s";
	};

	mt_soc_fm_mrgtx_pcm {
		compatible = "mediatek,mt_soc_pcm_fmtx";
	};

	mt_soc_hp_impedance_pcm {
		compatible = "mediatek,mt_soc_pcm_hp_impedance";
	};

	mt_soc_i2s0_awb_pcm {
		compatible = "mediatek,mt_soc_pcm_i2s0_awb";
	};

	mt_soc_i2s0_pcm {
		compatible = "mediatek,mt_soc_pcm_dl1_i2s0";
	};

	mt_soc_i2s0dl1_pcm {
		compatible = "mediatek,mt_soc_pcm_dl1_i2s0dl1";
	};

	mt_soc_mrgrx_awb_pcm {
		compatible = "mediatek,mt_soc_pcm_mrgrx_awb";
	};

	mt_soc_mrgrx_pcm {
		compatible = "mediatek,mt_soc_pcm_mrgrx";
	};

	mt_soc_pcm_dl1_scp_spk {
		compatible = "mediatek,mt_soc_pcm_dl1_scp_spk";
	};

	mt_soc_pcm_voice_scp {
		compatible = "mediatek,mt_soc_pcm_voice_scp";
	};

	mt_soc_pcm_voice_ultra {
		compatible = "mediatek,mt_soc_pcm_voice_ultra";
	};

	mt_soc_pcm_voice_usb {
		compatible = "mediatek,mt_soc_pcm_voice_usb";
	};

	mt_soc_pcm_voice_usb_echoref {
		compatible = "mediatek,mt_soc_pcm_voice_usb_echoref";
	};

	mt_soc_routing_dai_name {
		compatible = "mediatek,mt_soc_dai_routing";
	};

	mt_soc_routing_pcm {
		compatible = "mediatek,mt_soc_pcm_routing";
	};

	mt_soc_tdmrx_pcm {
		compatible = "mediatek,mt_soc_tdm_capture";
	};

	mt_soc_ul1_pcm {
		compatible = "mediatek,mt_soc_pcm_capture";
	};

	mt_soc_ul2_pcm {
		compatible = "mediatek,mt_soc_pcm_capture2";
	};

	mt_soc_uldlloopback_pcm {
		compatible = "mediatek,mt_soc_pcm_uldlloopback";
	};

	mt_soc_voice_md1 {
		compatible = "mediatek,mt_soc_pcm_voice_md1";
	};

	mt_soc_voice_md1_bt {
		compatible = "mediatek,mt_soc_pcm_voice_md1_bt";
	};

	mt_soc_voice_md2 {
		compatible = "mediatek,mt_soc_pcm_voice_md2";
	};

	mt_soc_voice_md2_bt {
		compatible = "mediatek,mt_soc_pcm_voice_md2_bt";
	};

	mt_soc_voip_bt_in {
		compatible = "mediatek,mt_soc_pcm_bt_dai";
	};

	mt_soc_voip_bt_out {
		compatible = "mediatek,mt_soc_pcm_dl1_bt";
	};

	mtk-btcvsd-snd@18050000 {
		compatible = "mediatek,mtk-btcvsd-snd";
		interrupts = <0x00 0x10a 0x08>;
		linux,phandle = <0x3f>;
		mediatek,infracfg = <0x24>;
		mediatek,offset = <0xf00 0x800 0x140 0x144 0x148>;
		phandle = <0x3f>;
		reg = <0x00 0x18050000 0x00 0x1000 0x00 0x18080000 0x00 0x10000>;
	};

	mtkfb@0 {
		compatible = "mediatek,mtkfb";
		linux,phandle = <0x96>;
		phandle = <0x96>;
	};

	nfc {
		compatible = "mediatek,nfc-gpio-v2";
		gpio-irq = <0x0a>;
		gpio-irq-std = <0x3c 0x0a 0x00>;
		gpio-rst = <0xac>;
		gpio-rst-std = <0x3c 0xac 0x00>;
		linux,phandle = <0x94>;
		phandle = <0x94>;
	};

	nfi@11018000 {
		compatible = "mediatek,nfi";
		reg = <0x00 0x11018000 0x00 0x1000>;
	};

	nfiecc@11019000 {
		compatible = "mediatek,nfiecc";
		reg = <0x00 0x11019000 0x00 0x1000>;
	};

	odm {
		compatible = "simple-bus";
		linux,phandle = <0xa1>;
		phandle = <0xa1>;
	};

	otg_iddig {
		compatible = "mediatek,usb_iddig_bi_eint";
		linux,phandle = <0x73>;
		phandle = <0x73>;
	};

	pericfg@10003000 {
		#clock-cells = <0x01>;
		compatible = "mediatek,pericfg\0syscon";
		linux,phandle = <0x4f>;
		phandle = <0x4f>;
		reg = <0x00 0x10003000 0x00 0x1000>;
	};

	pinctrl@1000b000 {
		#gpio-cells = <0x02>;
		#interrupt-cells = <0x04>;
		compatible = "mediatek,mt6765-pinctrl";
		gpio-controller;
		interrupt-controller;
		interrupts = <0x00 0xab 0x04>;
		linux,phandle = <0x3c>;
		mediatek,pctl-regmap = <0x12 0x13 0x14 0x15 0x16 0x17 0x18 0x19>;
		phandle = <0x3c>;
		pins-are-numbered;
		reg = <0x00 0x1000b000 0x00 0x1000>;

		msdc0@default {
			linux,phandle = <0x32>;
			phandle = <0x32>;

			pins_clk {
				drive-strength = [03];
			};

			pins_cmd {
				drive-strength = [03];
			};

			pins_dat {
				drive-strength = [03];
			};

			pins_ds {
				drive-strength = [03];
			};

			pins_rst {
				drive-strength = [03];
			};
		};

		msdc0@hs200 {
			linux,phandle = <0x34>;
			phandle = <0x34>;

			pins_clk {
				drive-strength = [04];
			};

			pins_cmd {
				drive-strength = [03];
			};

			pins_dat {
				drive-strength = [04];
			};

			pins_ds {
				drive-strength = [04];
			};

			pins_rst {
				drive-strength = [03];
			};
		};

		msdc0@hs400 {
			linux,phandle = <0x33>;
			phandle = <0x33>;

			pins_clk {
				drive-strength = [04];
			};

			pins_cmd {
				drive-strength = [03];
			};

			pins_dat {
				drive-strength = [04];
			};

			pins_ds {
				drive-strength = [04];
			};

			pins_rst {
				drive-strength = [03];
			};
		};

		msdc0@register_default {
			cmd_edge = [00];
			linux,phandle = <0x35>;
			phandle = <0x35>;
			rdata_edge = [00];
			wdata_edge = [00];
		};

		msdc1@ddr50 {
			linux,phandle = <0x3a>;
			phandle = <0x3a>;

			pins_clk {
				drive-strength = [03];
			};

			pins_cmd {
				drive-strength = [03];
			};

			pins_dat {
				drive-strength = [03];
			};
		};

		msdc1@default {
			linux,phandle = <0x37>;
			phandle = <0x37>;

			pins_clk {
				drive-strength = [03];
			};

			pins_cmd {
				drive-strength = [03];
			};

			pins_dat {
				drive-strength = [03];
			};
		};

		msdc1@register_default {
			cmd_edge = [00];
			linux,phandle = <0x3b>;
			phandle = <0x3b>;
			rdata_edge = [00];
			wdata_edge = [00];
		};

		msdc1@sdr104 {
			linux,phandle = <0x38>;
			phandle = <0x38>;

			pins_clk {
				drive-strength = [03];
			};

			pins_cmd {
				drive-strength = [03];
			};

			pins_dat {
				drive-strength = [03];
			};
		};

		msdc1@sdr50 {
			linux,phandle = <0x39>;
			phandle = <0x39>;

			pins_clk {
				drive-strength = [03];
			};

			pins_cmd {
				drive-strength = [03];
			};

			pins_dat {
				drive-strength = [03];
			};
		};

		msdc3@default {
			linux,phandle = <0x52>;
			phandle = <0x52>;

			pins_clk {
				drive-strength = [04];
			};

			pins_cmd {
				drive-strength = [04];
			};

			pins_dat {
				drive-strength = [04];
			};
		};

		msdc3@register_default {
			cmd_edge = [01];
			linux,phandle = <0x53>;
			phandle = <0x53>;
			rdata_edge = [01];
			wdata_edge = [01];
		};
	};

	plat_sram_flag@0011db00 {
		compatible = "mediatek,plat_sram_flag";
		reg = <0x00 0x10e5f0 0x00 0x10>;
	};

	pmic_clock_buffer_ctrl {
		compatible = "mediatek,pmic_clock_buffer";
		linux,phandle = <0xa3>;
		mediatek,clkbuf-config = <0x02 0x01 0x01 0x02 0x00 0x00 0x00>;
		mediatek,clkbuf-driving-current = <0x01 0x01 0x01 0x01 0x01 0x01 0x01>;
		mediatek,clkbuf-quantity = <0x07>;
		phandle = <0xa3>;
	};

	pmu {
		compatible = "arm,armv8-pmuv3";
		interrupt-parent = <0x11>;
		interrupts = <0x01 0x07 0x08>;
	};

	psci {
		compatible = "arm,psci-1.0";
		method = "smc";
	};

	pseudo_m4u {
		compatible = "mediatek,mt-pseudo_m4u";
		iommus = <0x4b 0x02>;
	};

	pseudo_m4u-larb0 {
		compatible = "mediatek,mt-pseudo_m4u-port";
		iommus = <0x4b 0x00 0x4b 0x01 0x4b 0x02 0x4b 0x03 0x4b 0x04 0x4b 0x05 0x4b 0x06 0x4b 0x07>;
		mediatek,larbid = <0x00>;
	};

	pseudo_m4u-larb1 {
		compatible = "mediatek,mt-pseudo_m4u-port";
		iommus = <0x4b 0x20 0x4b 0x21>;
		mediatek,larbid = <0x01>;
	};

	pseudo_m4u-larb2 {
		compatible = "mediatek,mt-pseudo_m4u-port";
		iommus = <0x4b 0x40 0x4b 0x41>;
		mediatek,larbid = <0x02>;
	};

	pseudo_m4u-larb3 {
		compatible = "mediatek,mt-pseudo_m4u-port";
		iommus = <0x4b 0x60 0x4b 0x61>;
		mediatek,larbid = <0x03>;
	};

	pwm@11006000 {
		clock-names = "PWM1-main\0PWM2-main\0PWM3-main\0PWM4-main\0PWM5-main\0PWM6-main\0PWM-HCLK-main\0PWM-main";
		clocks = <0x24 0x10 0x24 0x11 0x24 0x12 0x24 0x13 0x24 0x14 0x24 0x30 0x24 0x0f 0x24 0x15>;
		compatible = "mediatek,pwm";
		interrupts = <0x00 0x4d 0x08>;
		linux,phandle = <0x86>;
		phandle = <0x86>;
		reg = <0x00 0x11006000 0x00 0x10000>;
	};

	pwrap@1000d000 {
		compatible = "mediatek,pwrap";
		interrupts = <0x00 0xb3 0x04>;
		reg = <0x00 0x1000d000 0x00 0x1000>;
	};

	radio_md_cfg {
		compatible = "mediatek,radio_md_cfg";
		linux,phandle = <0xaa>;
		phandle = <0xaa>;
	};

	reserved-memory {
		#address-cells = <0x02>;
		#size-cells = <0x02>;
		linux,phandle = <0x4d>;
		phandle = <0x4d>;
		ranges;

		consys-reserve-memory {
			alignment = <0x00 0x1000000>;
			alloc-ranges = <0x00 0x40000000 0x00 0x80000000>;
			compatible = "mediatek,consys-reserve-memory";
			no-map;
			size = <0x00 0x400000>;
		};

		reserve-memory-scp_share {
			alignment = <0x00 0x1000000>;
			alloc-ranges = <0x00 0x40000000 0x00 0x50000000>;
			compatible = "mediatek,reserve-memory-scp_share";
			no-map;
			size = <0x00 0x300000>;
		};

		reserve-memory-sspm_share {
			alignment = <0x00 0x10000>;
			alloc-ranges = <0x00 0x40000000 0x00 0x60000000>;
			compatible = "mediatek,reserve-memory-sspm_share";
			no-map;
			size = <0x00 0x510000>;
			status = "okay";
		};

		soter-shared-mem {
			alloc-ranges = <0x00 0x40000000 0x00 0x50000000>;
			compatible = "microtrust,shared_mem";
			no-map;
			size = <0x00 0x200000>;
		};

		wifi-reserve-memory {
			alignment = <0x00 0x1000000>;
			alloc-ranges = <0x00 0x40000000 0x00 0x80000000>;
			compatible = "mediatek,wifi-reserve-memory";
			no-map;
			size = <0x00 0x300000>;
		};

		zmc-default {
			alignment = <0x00 0x10000000>;
			alloc-ranges = <0x00 0xc0000000 0x01 0x80000000>;
			compatible = "mediatek,zone_movable_cma";
			size = <0x00 0xffc00000>;
		};
	};

	scp@10500000 {
		compatible = "mediatek,scp";
		core_1 = "enable";
		interrupts = <0x00 0xc0 0x04>;
		reg = <0x00 0x10500000 0x00 0x40000 0x00 0x105c0000 0x00 0x3000 0x00 0x105c4000 0x00 0x1000 0x00 0x105d4000 0x00 0x6000>;
		scp_sramSize = <0x40000>;
		status = "okay";
	};

	scp_dvfs {
		clock-names = "clk_mux\0clk_pll_0\0clk_pll_1\0clk_pll_2\0clk_pll_3\0clk_pll_4\0clk_pll_5\0clk_pll_6";
		clocks = <0x1e 0x63 0x1f 0x1e 0x0e 0x1e 0x1a 0x1e 0x02 0x1e 0x17 0x1e 0x06 0x1e 0x19>;
		compatible = "mediatek,scp_dvfs";
	};

	scpsys@10001000 {
		#clock-cells = <0x01>;
		compatible = "mediatek,scpsys\0syscon";
		linux,phandle = <0x25>;
		phandle = <0x25>;
		reg = <0x00 0x10001000 0x00 0x1000 0x00 0x10006000 0x00 0x1000 0x00 0x14002000 0x00 0x1000 0x00 0x1020e000 0x00 0x1000 0x00 0x18004000 0x00 0x1000 0x00 0x18002000 0x00 0x1000>;
	};

	security_ao@1001a000 {
		compatible = "mediatek,security_ao";
		reg = <0x00 0x1001a000 0x00 0x1000>;
	};

	seninf1@1a040000 {
		compatible = "mediatek,seninf1";
		reg = <0x00 0x1a040000 0x00 0x1000>;
	};

	seninf2@1a041000 {
		compatible = "mediatek,seninf2";
		reg = <0x00 0x1a041000 0x00 0x1000>;
	};

	seninf3@1a042000 {
		compatible = "mediatek,seninf3";
		reg = <0x00 0x1a042000 0x00 0x1000>;
	};

	seninf4@1a043000 {
		compatible = "mediatek,seninf4";
		reg = <0x00 0x1a043000 0x00 0x1000>;
	};

	serial@11020000 {
		clock-names = "baud\0bus";
		clocks = <0x1f 0x24 0x16>;
		compatible = "mediatek,mt6758-uart\0mediatek,mt6577-uart";
		dma-names = "tx\0rx";
		dmas = <0x31 0x00 0x31 0x01>;
		interrupts = <0x00 0x5b 0x08>;
		linux,phandle = <0x7c>;
		phandle = <0x7c>;
		reg = <0x00 0x11002000 0x00 0x1000>;
	};

	serial@11030000 {
		clock-names = "baud\0bus";
		clocks = <0x1f 0x24 0x17>;
		compatible = "mediatek,mt6758-uart\0mediatek,mt6577-uart";
		interrupts = <0x00 0x5c 0x08>;
		linux,phandle = <0x7d>;
		phandle = <0x7d>;
		reg = <0x00 0x11003000 0x00 0x1000>;
	};

	sleep@10006000 {
		compatible = "mediatek,sleep";
		interrupts = <0x00 0xb5 0x08>;
		reg = <0x00 0x10006000 0x00 0x1000>;
		wakeup-source = <0x1a 0x00 0x04 0x1b 0x01 0x20 0x1c 0x03 0x2000000>;
	};

	sleep_reg_md@1000f000 {
		compatible = "mediatek,sleep_reg_md";
		reg = <0x00 0x1000f000 0x00 0x1000>;
	};

	smart_pa {
		linux,phandle = <0xa7>;
		phandle = <0xa7>;
	};

	smi_common@14002000 {
		clock-names = "mtcmos-mm\0smi-common-gals-comm0\0smi-common-gals-comm1\0smi-common\0mmdvfs_clk_mm_sel_ck\0mmdvfs_clk_mmpll_ck\0mmdvfs_clk_univpll1_d2_ck\0mmdvfs_clk_mmpll_d2_ck";
		clocks = <0x25 0x03 0x26 0x15 0x26 0x16 0x26 0x13 0x1e 0x62 0x1e 0x21 0x1e 0x17 0x1e 0x22>;
		compatible = "mediatek,smi_common";
		larbs = <0x20 0x21 0x22 0x23>;
		mmsys_config = <0x26>;
		nr_larbs = <0x04>;
		reg = <0x00 0x14002000 0x00 0x1000>;
	};

	smi_larb0@14003000 {
		cell-index = <0x00>;
		clock-names = "mtcmos-mm\0mm-larb0";
		clocks = <0x25 0x03 0x26 0x14>;
		compatible = "mediatek,smi_larb0\0mediatek,smi_larb";
		linux,phandle = <0x20>;
		phandle = <0x20>;
		reg = <0x00 0x14003000 0x00 0x1000>;
	};

	smi_larb1@17010000 {
		cell-index = <0x01>;
		clock-names = "mtcmos-vcodec\0venc-larb1";
		clocks = <0x25 0x0a 0x44 0x01>;
		compatible = "mediatek,smi_larb1\0mediatek,smi_larb";
		linux,phandle = <0x21>;
		phandle = <0x21>;
		reg = <0x00 0x17010000 0x00 0x1000>;
	};

	smi_larb2@15021000 {
		cell-index = <0x02>;
		clock-names = "mtcmos-isp\0gals-img2mm\0img-larb2";
		clocks = <0x25 0x05 0x26 0x18 0x42 0x00>;
		compatible = "mediatek,smi_larb2\0mediatek,smi_larb";
		linux,phandle = <0x22>;
		phandle = <0x22>;
		reg = <0x00 0x15021000 0x00 0x1000>;
	};

	smi_larb3@1a002000 {
		cell-index = <0x03>;
		clock-names = "mtcmos-cam\0gals-cam2mm\0cam-larb3";
		clocks = <0x25 0x09 0x26 0x19 0x43 0x00>;
		compatible = "mediatek,smi_larb3\0mediatek,smi_larb";
		linux,phandle = <0x23>;
		phandle = <0x23>;
		reg = <0x00 0x1a002000 0x00 0x1000>;
	};

	spi@1100a000 {
		clock-names = "parent-clk\0sel-clk\0spi-clk";
		clocks = <0x1e 0x0b 0x1e 0x6b 0x24 0x1b>;
		compatible = "mediatek,mt6765-spi";
		interrupts = <0x00 0x76 0x08>;
		linux,phandle = <0x87>;
		mediatek,pad-select = <0x00>;
		phandle = <0x87>;
		reg = <0x00 0x1100a000 0x00 0x1000>;
	};

	spi@11010000 {
		clock-names = "parent-clk\0sel-clk\0spi-clk";
		clocks = <0x1e 0x0b 0x1e 0x6b 0x24 0x34>;
		compatible = "mediatek,mt6765-spi";
		interrupts = <0x00 0x7a 0x08>;
		linux,phandle = <0x88>;
		mediatek,pad-select = <0x00>;
		phandle = <0x88>;
		reg = <0x00 0x11010000 0x00 0x1000>;
	};

	spi@11012000 {
		clock-names = "parent-clk\0sel-clk\0spi-clk";
		clocks = <0x1e 0x0b 0x1e 0x6b 0x24 0x37>;
		compatible = "mediatek,mt6765-spi";
		interrupts = <0x00 0x80 0x08>;
		linux,phandle = <0x89>;
		mediatek,pad-select = <0x00>;
		phandle = <0x89>;
		reg = <0x00 0x11012000 0x00 0x1000>;
	};

	spi@11013000 {
		clock-names = "parent-clk\0sel-clk\0spi-clk";
		clocks = <0x1e 0x0b 0x1e 0x6b 0x24 0x38>;
		compatible = "mediatek,mt6765-spi";
		interrupts = <0x00 0x81 0x08>;
		linux,phandle = <0x8a>;
		mediatek,pad-select = <0x00>;
		phandle = <0x8a>;
		reg = <0x00 0x11013000 0x00 0x1000>;
	};

	spi@11014000 {
		clock-names = "parent-clk\0sel-clk\0spi-clk";
		clocks = <0x1e 0x0b 0x1e 0x6b 0x24 0x41>;
		compatible = "mediatek,mt6765-spi";
		interrupts = <0x00 0x5f 0x08>;
		linux,phandle = <0x8b>;
		mediatek,pad-select = <0x00>;
		phandle = <0x8b>;
		reg = <0x00 0x11014000 0x00 0x1000>;
	};

	spi@11015000 {
		clock-names = "parent-clk\0sel-clk\0spi-clk";
		clocks = <0x1e 0x0b 0x1e 0x6b 0x24 0x42>;
		compatible = "mediatek,mt6765-spi";
		interrupts = <0x00 0x60 0x08>;
		linux,phandle = <0x8c>;
		mediatek,pad-select = <0x00>;
		phandle = <0x8c>;
		reg = <0x00 0x11015000 0x00 0x1000>;
	};

	sramrom@10214000 {
		compatible = "mediatek,sramrom";
		reg = <0x00 0x10214000 0x00 0x1000>;
	};

	sspm@10440000 {
		compatible = "mediatek,sspm";
		interrupt-names = "ipc\0mbox0\0mbox1\0mbox2\0mbox3\0mbox4";
		interrupts = <0x00 0xca 0x04 0x00 0xcd 0x04 0x00 0xce 0x04 0x00 0xcf 0x04 0x00 0xd0 0x04 0x00 0xd1 0x04>;
		reg = <0x00 0x10440000 0x00 0x10000 0x00 0x10450000 0x00 0x100 0x00 0x10451000 0x00 0x08 0x00 0x10460000 0x00 0x100 0x00 0x10461000 0x00 0x08 0x00 0x10470000 0x00 0x100 0x00 0x10471000 0x00 0x08 0x00 0x10480000 0x00 0x100 0x00 0x10481000 0x00 0x08 0x00 0x10490000 0x00 0x100 0x00 0x10491000 0x00 0x08>;
		reg-names = "cfgreg\0mbox0_base\0mbox0_ctrl\0mbox1_base\0mbox1_ctrl\0mbox2_base\0mbox2_ctrl\0mbox3_base\0mbox3_ctrl\0mbox4_base\0mbox4_ctrl";
	};

	sys_cirq@10204000 {
		compatible = "mediatek,sys_cirq";
		interrupts = <0x00 0x118 0x08>;
		mediatek,cirq_num = <0xd1>;
		mediatek,spi_start_offset = <0x48>;
		reg = <0x00 0x10204000 0x00 0x1000>;
	};

	sys_timer@10017000 {
		compatible = "mediatek,sys_timer";
		interrupts = <0x00 0xc2 0x04>;
		reg = <0x00 0x10017000 0x00 0x1000>;
		reg-names = "sys_timer_base";
	};

	syscfg_pctl_0@10005000 {
		compatible = "mediatek,mt6765-pctl-0-syscfg\0syscon";
		linux,phandle = <0x12>;
		phandle = <0x12>;
		reg = <0x00 0x10005000 0x00 0x1000>;
	};

	syscfg_pctl_1@0x10002000 {
		compatible = "mediatek,mt6765-pctl-1-syscfg\0syscon";
		linux,phandle = <0x13>;
		phandle = <0x13>;
		reg = <0x00 0x10002000 0x00 0x1000>;
	};

	syscfg_pctl_2@0x10002200 {
		compatible = "mediatek,mt6765-pctl-2-syscfg\0syscon";
		linux,phandle = <0x14>;
		phandle = <0x14>;
		reg = <0x00 0x10002200 0x00 0x1000>;
	};

	syscfg_pctl_3@0x10002400 {
		compatible = "mediatek,mt6765-pctl-3-syscfg\0syscon";
		linux,phandle = <0x15>;
		phandle = <0x15>;
		reg = <0x00 0x10002400 0x00 0x1000>;
	};

	syscfg_pctl_4@0x10002600 {
		compatible = "mediatek,mt6765-pctl-4-syscfg\0syscon";
		linux,phandle = <0x16>;
		phandle = <0x16>;
		reg = <0x00 0x10002600 0x00 0x1000>;
	};

	syscfg_pctl_5@0x10002800 {
		compatible = "mediatek,mt6765-pctl-5-syscfg\0syscon";
		linux,phandle = <0x17>;
		phandle = <0x17>;
		reg = <0x00 0x10002800 0x00 0x1000>;
	};

	syscfg_pctl_6@0x10002a00 {
		compatible = "mediatek,mt6765-pctl-6-syscfg\0syscon";
		linux,phandle = <0x18>;
		phandle = <0x18>;
		reg = <0x00 0x10002a00 0x00 0x1000>;
	};

	syscfg_pctl_7@0x10002c00 {
		compatible = "mediatek,mt6765-pctl-7-syscfg\0syscon";
		linux,phandle = <0x19>;
		phandle = <0x19>;
		reg = <0x00 0x10002c00 0x00 0x1000>;
	};

	therm_ctrl@1100b000 {
		clock-names = "therm-main";
		clocks = <0x24 0x0a>;
		compatible = "mediatek,therm_ctrl";
		interrupts = <0x00 0x4e 0x08>;
		reg = <0x00 0x1100b000 0x00 0x1000>;
	};

	timer {
		clock-frequency = <0xc65d40>;
		compatible = "arm,armv8-timer";
		interrupt-parent = <0x11>;
		interrupts = <0x01 0x0d 0x08 0x01 0x0e 0x08 0x01 0x0b 0x08 0x01 0x0a 0x08>;
	};

	tkcore {
		compatible = "trustkernel,tkcore";
		interrupts = <0x00 0xf8 0x01>;
	};

	topckgen@10000000 {
		#clock-cells = <0x01>;
		compatible = "mediatek,topckgen\0syscon";
		linux,phandle = <0x1e>;
		phandle = <0x1e>;
		reg = <0x00 0x10000000 0x00 0x1000>;
	};

	topckgen_ao@1001b000 {
		compatible = "mediatek,topckgen_ao";
		reg = <0x00 0x1001b000 0x00 0x1000>;
	};

	topmisc@10011000 {
		compatible = "mediatek,topmisc";
		reg = <0x00 0x10011000 0x00 0x1000>;
	};

	toprgu@10007000 {
		compatible = "mediatek,mt6765-toprgu";
		interrupts = <0x00 0x8b 0x00>;
		reg = <0x00 0x10007000 0x00 0x1000>;
	};

	touch {
		compatible = "mediatek,touch";
		linux,phandle = <0x75>;
		phandle = <0x75>;
	};

	tran_battery {
		compatible = "tran,chg_fun";
		enable_pcb_tml;
		jeita_above_t4_chg_cur = <0x00>;
		jeita_above_t4_input_cur = <0xf4240>;
		jeita_above_t4_topoff_voltage = <0x3c45b0>;
		jeita_below_t0_chg_cur = <0x00>;
		jeita_below_t0_input_cur = "\0\f5";
		jeita_below_t0_topoff_voltage = <0x401640>;
		jeita_t0_to_t1_chg_cur = "\0\f5";
		jeita_t0_to_t1_input_cur = "\0\f5";
		jeita_t0_to_t1_topoff_voltage = <0x401640>;
		jeita_t1_to_t2_topoff_voltage = <0x401640>;
		jeita_t2_to_t3_chg_cur = <0x1cafc0>;
		jeita_t2_to_t3_input_cur = <0x1cafc0>;
		jeita_t2_to_t3_topoff_voltage = <0x401640>;
		jeita_t3_to_t4_chg_cur = <0x1cafc0>;
		jeita_t3_to_t4_input_cur = <0x1cafc0>;
		jeita_t3_to_t4_topoff_voltage = <0x3c45b0>;
		linux,phandle = <0x9f>;
		pcb_cur_step_one = <0x190>;
		pcb_cur_step_two = <0xc8>;
		pcb_min_chg_cur = <0x120160>;
		pcb_temp_step_one = <0xa410>;
		pcb_temp_step_two = <0xa7f8>;
		phandle = <0x9f>;
	};

	trng@1020f000 {
		compatible = "mediatek,trng";
		interrupts = <0x00 0xa1 0x08>;
		reg = <0x00 0x1020f000 0x00 0x1000>;
	};

	type_c_port0 {
		linux,phandle = <0xad>;
		mt-tcpc,name = "type_c_port0";
		mt-tcpc,role_def = <0x04>;
		mt-tcpc,rp_level = <0x00>;
		mt-tcpc,vconn_supply = <0x01>;
		mt6370pd,intr_gpio = <0x3c 0x18 0x00>;
		mt6370pd,intr_gpio_num = <0x18>;
		phandle = <0xad>;
		tcpc-dual,supported_modes = <0x00>;

		dpm_caps {
			attemp_discover_cable;
			attemp_discover_id;
			attemp_enter_dp_mode;
			dr_check = <0x00>;
			local_dr_data;
			local_dr_power;
			local_no_suspend;
			local_usb_comm;
			local_vconn_supply;
			pr_check = <0x00>;
			pr_check_gp_source;
		};

		pd-data {
			bat,nr = <0x01>;
			pd,charging_policy = <0x21>;
			pd,country_nr = <0x00>;
			pd,id-vdo-data = <0xd10029cf 0x00 0x10000>;
			pd,id-vdo-size = <0x03>;
			pd,mfrs = "RichtekTCPC";
			pd,pid = <0x5081>;
			pd,sink-pdo-data = <0x190c8 0xc0761e3c>;
			pd,sink-pdo-size = <0x02>;
			pd,source-cap-ext = <0x171129cf 0x00 0x102 0x00 0x00 0x2000000>;
			pd,source-pdo-data = <0x19032>;
			pd,source-pdo-size = <0x01>;
			pd,vid = <0x29cf>;

			bat-info0 {
				bat,design_cap = <0xbb8>;
				bat,mfrs = "bat1";
				bat,pid = <0x1711>;
				bat,vid = <0x29cf>;
			};
		};
	};

	usb0@11200000 {
		clock-names = "usb0\0usb0_clk_top_sel\0usb0_clk_univpll3_d4";
		clocks = <0x24 0x08 0x1e 0x76 0x1e 0x20>;
		compatible = "mediatek,mt6765-usb20";
		interrupts = <0x00 0x49 0x08>;
		mode = <0x02>;
		multipoint = <0x01>;
		num_eps = <0x10>;
		reg = <0x00 0x11200000 0x00 0x10000 0x00 0x11cc0000 0x00 0x10000>;
	};

	usb1p_sif@11210000 {
		compatible = "mediatek,usb1p_sif";
		reg = <0x00 0x11210000 0x00 0x10000>;
	};

	usb_sif@11210000 {
		compatible = "mediatek,usb_sif";
		reg = <0x00 0x11210000 0x00 0x10000>;
	};

	utos {
		compatible = "microtrust,utos";
		interrupts = <0x00 0xf9 0x01 0x00 0xfa 0x01>;
	};

	utos_tester {
		compatible = "microtrust,tester-v1";
	};

	vdec@17040000 {
		compatible = "mediatek,vdec";
		interrupts = <0x00 0xe9 0x08>;
		reg = <0x00 0x17040000 0x00 0x10000>;
	};

	venc@17020000 {
		compatible = "mediatek,venc";
		interrupts = <0x00 0xe6 0x08>;
		reg = <0x00 0x17020000 0x00 0x10000>;
	};

	venc_gcon@17000000 {
		#clock-cells = <0x01>;
		clock-names = "MT_SCP_SYS_DIS\0MT_SCP_SYS_VCODEC\0MT_CG_MM_SMI_COMM0\0MT_CG_MM_SMI_COMM1\0MT_CG_MM_SMI_COMMON\0MT_CG_VDEC\0MT_CG_VENC";
		clocks = <0x25 0x03 0x25 0x0a 0x26 0x15 0x26 0x16 0x26 0x13 0x44 0x03 0x44 0x01>;
		compatible = "mediatek,venc_gcon\0syscon";
		linux,phandle = <0x44>;
		phandle = <0x44>;
		reg = <0x00 0x17000000 0x00 0x10000>;
	};

	venc_jpg@17030000 {
		clock-names = "MT_CG_VENC_JPGENC";
		clocks = <0x44 0x02>;
		compatible = "mediatek,venc_jpg";
		interrupts = <0x00 0xe8 0x08>;
		reg = <0x00 0x17030000 0x00 0x10000>;
	};

	wifi@18000000 {
		compatible = "mediatek,wifi";
		interrupts = <0x00 0x10c 0x08>;
		reg = <0x00 0x18000000 0x00 0x100000>;
	};
};
